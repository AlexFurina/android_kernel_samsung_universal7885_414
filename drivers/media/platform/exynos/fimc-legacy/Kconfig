## drivers/media/platform/exynos/fimc-legacy/Kconfig
```kconfig
config VIDEO_EXYNOS_FIMC_LEGACY
        bool "Exynos FIMC-LEGACY (Image Subsystem) driver"
        depends on VIDEO_EXYNOS
        select MEDIA_EXYNOS
        select EXYNOS_FIMC_IS
        default n
        help
          This is a v4l2 driver for exynos FIMC-IS device.

source "drivers/media/platform/exynos/fimc-legacy/ischain/Kconfig"
source "drivers/media/platform/exynos/fimc-legacy/sensor/Kconfig"

#menu depth1
menu "Base Feature Setting"
	depends on EXYNOS_FIMC_IS

source "drivers/media/platform/exynos/fimc-legacy/hardware/Kconfig"
endmenu

source "drivers/media/platform/exynos/fimc-legacy/vendor/Kconfig"
```
