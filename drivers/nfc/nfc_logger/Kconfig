## drivers/nfc/nfc_logger/Kconfig
```kconfig
config SEC_NFC_LOGGER
	bool "NFC logger"
	default n
	help
	  support for saving nfc log.
	  This option enables device driver support for nfc log.
	  help for debugging.

	  If unsure, say N.
```

## drivers/usb/typec/Kconfig
```kconfig
menu "USB Power Delivery and Type-C drivers"

config TYPEC
	tristate
	default y

source "drivers/usb/typec/manager/Kconfig"

source "drivers/usb/typec/common/Kconfig"

source "drivers/usb/typec/slsi/Kconfig"

endmenu
```

## drivers/usb/typec/slsi/Kconfig
```kconfig
source "drivers/usb/typec/slsi/common/Kconfig"
source "drivers/usb/typec/slsi/s2mu004/Kconfig"
source "drivers/usb/typec/slsi/s2mu106/Kconfig"
```

## drivers/usb/typec/slsi/s2mu004/Kconfig
```kconfig
#
# PDIC devices
#

comment "PDIC configs"

config PDIC_S2MU004
	bool "Using S2MU004 USB PD"
	depends on PDIC_SLSI_NON_MCU
	default n
	help
	  If you say yes here you will get support for
	  for the S2MU004 USBPD chip.
```

## drivers/vibrator/Kconfig
```kconfig
config MOTOR_S2MU106
	tristate "s2mu106 haptic driver"
	default n
	depends on I2C
	help
	 Say Y to include support for System LSI s2mu106
	 Haptic driver.
	 The Haptic Motor driver support both ERM and
	 LRA type actuators.

config MOTOR_VOLTAGE_3P3
	bool "Using MOTOR VOLTAGE 3P3"
	depends on MOTOR_S2MU106
	default n
	help
		If you say yes here you will get support for
		for the  MOTOR VOLTAGE 3P3 feature.
```

## drivers/video/fbdev/exynos/dpu_7885/panels/Kconfig
```kconfig
config EXYNOS_DECON_LCD
	depends on EXYNOS_DECON_7885
	bool "Select LCD panel driver"

config EXYNOS_DECON_LCD_S6E3FA0
	depends on EXYNOS_DECON_LCD && EXYNOS_MIPI_DSIM
	tristate "S6E3FA0 AMOLED FHD LCD driver(1080 x 1920)"

config EXYNOS_DECON_LCD_S6E3FA3
	depends on EXYNOS_DECON_LCD && EXYNOS_MIPI_DSIM
	tristate "S6E3FA3 AMOLED FHD LCD driver(1080 x 1920)"

config EXYNOS_DECON_LCD_S6E3HA2K
	depends on EXYNOS_DECON_LCD && EXYNOS_MIPI_DSIM
	tristate "S6E3HA2K AMOLED WQHD LCD driver(1440 x 2560)"

config EXYNOS_DECON_LCD_S6E3HF4
	depends on EXYNOS_DECON_LCD && EXYNOS_MIPI_DSIM
	tristate "S6E3HF4 AMOLED WQHD LCD driver(1440 x 2560)"

config EXYNOS_DECON_LCD_EMUL_DISP
	depends on EXYNOS_DECON_LCD && EXYNOS_MIPI_DSIM
	depends on EXYNOS_ZEBU_EMUL_DISP
	tristate "EMUL_DISP COMMAND/VIDEO MODE AMOLED FHD LCD driver(800 x 1280)"

config EXYNOS_DECON_LCD_S6E3FA7
	depends on EXYNOS_DECON_LCD && EXYNOS_MIPI_DSIM
	tristate "S6E3FA7 AMOLED FHD+ LCD driver(1080 x 2220)"

config SMCDSD_LCD_DEBUG
	bool "SMCDSD_LCD_DEBUG"
	default n

config DISPLAY_USE_INFO
	bool "Support display use info logging"
	default n

config EXYNOS_DECON_MDNIE
	bool "Support MDNIE"
	default n

config SUPPORT_POC_FLASH
	depends on EXYNOS_DECON_LCD
	bool "Support display poc flash"
	default n

config EXYNOS_DECON_LCD_HX83102D_A10EU
	bool "HX83102D_A10E LCD driver"

config EXYNOS_DECON_LCD_S6E3FA7_JACKPOT2
	bool "S6E3FA7_JACKPOT2 LCD driver"

config EXYNOS_DECON_LCD_S6E3FA7_JACKPOT
	bool "S6E3FA7_JACKPOT LCD driver"
```
