## drivers/gud/Kconfig
```kconfig
#
# Mobicore Configuration
#
if SOC_EXYNOS9610
source "drivers/gud/gud-exynos9610/Kconfig"
endif

if SOC_EXYNOS9810
source "drivers/gud/gud-exynos9810/Kconfig"
endif

if SOC_EXYNOS7885
source "drivers/gud/gud-exynos7885/Kconfig"
endif
```

## drivers/pinctrl/cirrus/Kconfig
```kconfig
config PINCTRL_MADERA
	bool
	select PINMUX
	select GENERIC_PINCONF
	default y if MFD_MADERA=y

config PINCTRL_CS47L92
	bool
```

## drivers/video/fbdev/exynos/Kconfig
```kconfig
if SOC_EXYNOS9610

source "drivers/video/fbdev/exynos/dpu20/Kconfig"

endif # SOC_EXYNOS9610

if SOC_EXYNOS7885
source "drivers/video/fbdev/exynos/dpu_7885/Kconfig"
endif

if SOC_EXYNOS9810

source "drivers/video/fbdev/exynos/dpu_9810/Kconfig"

endif # SOC_EXYNOS9810
```
