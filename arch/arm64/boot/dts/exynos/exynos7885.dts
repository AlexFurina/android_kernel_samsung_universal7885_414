/*
 * SAMSUNG EXYNOS7885 SoC device tree source
 *
 * Copyright (c) 2014 Samsung Electronics Co., Ltd.
 *		http://www.samsung.com
 *
 * SAMSUNG EXYNOS7885 SoC device nodes are listed in this file.
 * EXYNOS7885 based board files can include this file and provide
 * values for board specfic bindings.
 *
 * This program is free software; you can redistribute it and/or modify
 * it under the terms of the GNU General Public License version 2 as
 * published by the Free Software Foundation.
 */

/dts-v1/;
#include "exynos7885.dtsi"

/ {
	compatible = "samsung,armv8", "samsung,exynos7885";
	dtb-hw_rev = <0>;
	dtb-hw_rev_end = <255>;
};
