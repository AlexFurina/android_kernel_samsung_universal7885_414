/*
 * SAMSUNG EXYNOS9810 board device tree source
 *
 * Copyright (c) 2017 Samsung Electronics Co., Ltd.
 *		http://www.samsung.com
 *
 * This program is free software; you can redistribute it and/or modify
 * it under the terms of the GNU General Public License version 2 as
 * published by the Free Software Foundation.
 */

/ {
	/* USI08_USI */
	hsi2c_20: hsi2c@108E0000 {
		gpios = <&gpp5 0 0 &gpp5 1 0>;
		status = "okay";
		clock-frequency = <400000>;
		sec-nfc@27 {
			compatible = "sec-nfc";
			reg = <0x27>;

			interrupts = <2 0 0>;
			interrupt-parent = <&gpa1>;

			sec-nfc,ven-gpio = <&expander_gpios 11 0>;
			sec-nfc,irq-gpio = <&gpa1 2 0>;
			sec-nfc,firm-gpio = <&expander_gpios 9 0>;
			sec-nfc,clk_req-gpio = <&gpa2 6 0xf>;
			sec-nfc,clk_use = <2>;
			sec-nfc,nfc_pvdd = "VDD_NFC_1P8";

			clocks = <&clock OSC_NFC>;
			clock-names = "oscclk_nfc";
			sec-nfc,nfc_ap_clk;
			sec-nfc,ldo_control;
		};
	};
};