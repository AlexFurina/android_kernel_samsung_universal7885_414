/*
 * SAMSUNG EXYNOS9810 SoC device tree source
 *
 * Copyright (c) 2017 Samsung Electronics Co., Ltd.
 *              http://www.samsung.com
 *
 * SAMSUNG EXYNOS9810 SoC device nodes are listed in this file.
 * EXYNOS9810 based board files can include this file and provide
 * values for board specfic bindings.
 *
 * This program is free software; you can redistribute it and/or modify
 * it under the terms of the GNU General Public License version 2 as
 * published by the Free Software Foundation.
 */

/ {
        acpm_dvfs {
                compatible = "samsung,exynos-acpm-dvfs";
                acpm-ipc-channel = <5>;
        };

        acpm_s2d {
                compatible = "samsung,exynos-acpm-s2d";
                acpm-ipc-channel = <11>;
        };

        acpm {
                compatible = "samsung,exynos-acpm";
                #address-cells = <2>;
                #size-cells = <1>;
                acpm-ipc-channel = <4>;
                fvmap_offset = <0x6700>;
                reg = <0x0 0x14020000 0x1000>;          /* TIMER_APM */
                reg-names = "timer_apm";
                peritimer-cnt = <0xFFFF>;
	};
};
