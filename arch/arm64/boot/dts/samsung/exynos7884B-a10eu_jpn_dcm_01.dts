/dts-v1/;

/ {
	compatible = "samsung,A10EU JPN DCM 01", "samsung,EXYNOS7884B";
	dtbo-hw_rev = <0x1>;
	dtbo-hw_rev_end = <0xff>;

	fragment@lcd {
		target-path = [2f 00];

		__overlay__ {

			decon_board_hx83102d {
				gpio_lcd_3p0 = <0xffffffff 0x2 0x0>;
				gpio_lcd_rst = <0xffffffff 0x0 0x0>;
				gpio_blic_on = <0xffffffff 0x0 0x0>;
				linux,phandle = <0x1>;
				phandle = <0x1>;

				dsim_set_panel_power_early {
					type = "gpio,high", "gpio_lcd_3p0", "delay,usleep", "1000", "gpio,high", "gpio_blic_on", "delay,usleep", "1000";
				};

				dsim_set_panel_power_disable {
					type = "delay,msleep", "34", "gpio,low", "gpio_lcd_rst", "delay,usleep", "5000";
				};

				dsim_set_panel_power_disable_late {
					type = "gpio,low", "gpio_blic_on", "gpio,low", "gpio_lcd_3p0";
				};

				dsim_reset_panel {
					type = "gpio,high", "gpio_lcd_rst", "delay,usleep", "1000", "gpio,low", "gpio_lcd_rst", "delay,usleep", "1000", "gpio,high", "gpio_lcd_rst", "delay,msleep", "60";
				};
			};

			hx83102d {
				mode = <0x0>;
				resolution = <0x2d0 0x618>;
				size = <0x3e 0x87>;
				timing,refresh = <0x3c>;
				timing,h-porch = <0x1a 0x96 0xc>;
				timing,v-porch = <0xc 0xfe 0x2>;
				timing,dsi-hs-clk = <0x256>;
				timing,pms = <0x2 0x5c 0x1>;
				timing,dsi-escape-clk = <0x10>;
				mic_en = <0x0>;
				mic_ratio = <0x0>;
				mic_ver = <0x0>;
				type_of_ddi = <0x0>;
				dsc_en = <0x0>;
				dsc_cnt = <0x0>;
				dsc_slice_num = <0x0>;
				data_lane = <0x4>;
				vt_compensation = <0x1c7>;
				eotp_disabled = <0x1>;
				decon_board = <0x1>;
				linux,phandle = <0x2>;
				phandle = <0x2>;
			};
		};
	};

	fragment@0 {
		target = <0xffffffff>;

		__overlay__ {
			lcd_info = <0x2>;
		};
	};

	fragment@1 {
		target = <0xffffffff>;

		__overlay__ {
			psr_mode = <0x0>;
			trig_mode = <0x1>;
			dsi_mode = <0x0>;
		};
	};

	fragment@2 {
		target = <0xffffffff>;

		__overlay__ {
			samsung,pins = "gpp2-1", "gpp2-0";
			samsung,pin-function = <0x2>;
			samsung,pin-pud = <0x0>;
			samsung,pin-drv = <0x0>;
		};
	};

	fragment@3 {
		target = <0xffffffff>;

		__overlay__ {
			status = "okay";
			samsung,i2c-max-bus-freq = <0x61a80>;

			lm36274@11 {
				compatible = "i2c,lm36274";
				reg = <0x11>;
			};
		};
	};

	fragment@ifpmic {
		target-path = [2f 00];

		__overlay__ {
			#address-cells = <0x2>;
			#size-cells = <0x1>;

			pinctrl@11CB0000 {

				if-pmic-irq {
					samsung,pins = "gpa2-2";
					samsung,pin-function = <0x0>;
					samsung,pin-pud = <0x0>;
					samsung,pin-drv = <0x0>;
					linux,phandle = <0x3>;
					phandle = <0x3>;
				};

				usbpd-irq {
					samsung,pins = "gpa2-3";
					samsung,pin-function = <0xf>;
					samsung,pin-pud = <0x0>;
					samsung,pin-drv = <0x0>;
					linux,phandle = <0x4>;
					phandle = <0x4>;
				};
			};

			i2c@13840000 {
				#address-cells = <0x1>;
				#size-cells = <0x0>;
				status = "okay";
				samsung,glitch-filter;
				samsung,fix-doxfer-return;
				samsung,i2c-max-bus-freq = <0x61a80>;

				s2mu106@3D {
					status = "okay";
					compatible = "samsung,s2mu106mfd";
					reg = <0x3d>;
					pinctrl-names = "default";
					pinctrl-0 = <0x3>;
					s2mu106,irq-gpio = <0xffffffff 0x2 0x1>;
					s2mu106,wakeup;
				};
			};

			i2c@13830000 {
				i2c-gpio,delay-us = <0x5>;
				status = "okay";
				samsung,glitch-filter;
				samsung,fix-doxfer-return;

				usbpd-s2mu106@3C {
					compatible = "sec-usbpd,i2c";
					reg = <0x3c>;
					pinctrl-names = "default";
					pinctrl-0 = <0x4>;
					usbpd,usbpd_int = <0xffffffff 0x3 0x0>;

					pdic-manager {
						pdic,max_power = <0x1388>;
						pdic,op_power = <0x9c4>;
						pdic,max_voltage = <0x1770>;
						pdic,max_current = <0x7d0>;
						pdic,min_current = <0x1f4>;
						pdic,giveback = <0x0>;
						pdic,usb_com_capable = <0x1>;
						pdic,no_usb_suspend = <0x1>;
						source,max_voltage = <0x1388>;
						source,min_voltage = <0xfa0>;
						source,max_power = <0x9c4>;
						sink,capable_max_voltage = <0x2328>;
					};
				};
			};
		};
	};

	fragment@modemif {
		target-path = [2f 00];

		__overlay__ {
			#address-cells = <0x2>;
			#size-cells = <0x1>;

			mif_pdata {
				reg = <0x0 0x10000 0x0>;
				compatible = "sec_modem,modem_pdata";
				status = "okay";
				interrupts = <0x0 0x13 0x0 0x0 0xd9 0x0>;
				gpios = <0xffffffff 0x7 0x0 0xffffffff 0x0 0x0 0xffffffff 0x1 0x0>;
				mif,name = "s327ap";
				mif,modem_net = <0x0>;
				mif,modem_type = <0xa>;
				mif,use_handover = <0x0>;
				mif,ipc_version = <0x32>;
				mif,link_types = <0x200>;
				mif,link_name = "shmem";
				mif,link_attrs = <0x7c9>;
				mif,num_iodevs = <0x18>;
				mbx_ap2cp_msg = <0x0>;
				mbx_cp2ap_msg = <0x1>;
				mbx_ap2cp_united_status = <0x2>;
				mbx_cp2ap_united_status = <0x3>;
				mbx_ap2cp_mif_value = <0x4>;
				mbx_ap2cp_kerneltime = <0x9>;
				mif,int_ap2cp_msg = <0x0>;
				mif,int_ap2cp_wakeup = <0x1>;
				mif,int_ap2cp_status = <0x2>;
				mif,int_ap2cp_active = <0x3>;
				mif,irq_cp2ap_msg = <0x0>;
				mif,irq_cp2ap_status = <0x2>;
				mif,irq_cp2ap_active = <0x3>;
				mif,irq_cp2ap_wakelock = <0x8>;
				mif,int_ap2cp_uart_noti = <0xf>;
				mbx_cp2ap_dvfsreq = <0x4>;
				mbx_cp2ap_dvfsreq_cpu = <0x5>;
				mbx_cp2ap_dvfsreq_mif = <0x6>;
				mbx_cp2ap_dvfsreq_int = <0x7>;
				mif,irq_cp2ap_perf_req_cpu = <0x5>;
				mif,irq_cp2ap_perf_req_mif = <0x6>;
				mif,irq_cp2ap_perf_req_int = <0x7>;
				sbi_cp_rat_mode_mask = <0x3f>;
				sbi_cp_rat_mode_pos = <0x1a>;
				sbi_cp_evs_mode_mask = <0x1>;
				sbi_cp_evs_mode_pos = <0x7>;
				sbi_cp2ap_wakelock_mask = <0x1>;
				sbi_cp2ap_wakelock_pos = <0x6>;
				sbi_lte_active_mask = <0x1>;
				sbi_lte_active_pos = <0x5>;
				sbi_cp_status_mask = <0xf>;
				sbi_cp_status_pos = <0x1>;
				sbi_pda_active_mask = <0x1>;
				sbi_pda_active_pos = <0x5>;
				sbi_ap_status_mask = <0xf>;
				sbi_ap_status_pos = <0x1>;
				sbi_crash_type_mask = <0xf>;
				sbi_crash_type_pos = <0x19>;
				sbi_device_type_mask = <0x1f>;
				sbi_device_type_pos = <0x14>;
				sbi_ext_backtrace_mask = <0x1>;
				sbi_ext_backtrace_pos = <0x11>;
				sbi_ds_det_mask = <0x3>;
				sbi_ds_det_pos = <0xe>;
				sbi_sys_rev_mask = <0xff>;
				sbi_sys_rev_pos = <0x6>;
				sbi_lockval_cp2ap_dvfsreq_endian_mask = <0x1>;
				sbi_lockval_cp2ap_dvfsreq_endian_pos = <0x1f>;
				sbi_lockval_cp2ap_dvfsreq_index_mask = <0x7fff>;
				sbi_lockval_cp2ap_dvfsreq_index_pos = <0x0>;
				sbi_ap2cp_kerneltime_sec_mask = <0xfff>;
				sbi_ap2cp_kerneltime_sec_pos = <0x14>;
				sbi_ap2cp_kerneltime_usec_mask = <0xfffff>;
				sbi_ap2cp_kerneltime_usec_pos = <0x0>;
				sbi_uart_noti_mask = <0x1>;
				sbi_uart_noti_pos = <0x10>;

				iodevs {

					io_device_0 {
						iod,name = "umts_cass";
						iod,id = <0x23>;
						iod,format = <0x1>;
						iod,io_type = <0x0>;
						iod,links = <0x200>;
						iod,attrs = <0x2082>;
						iod,max_tx_size = <0x800>;
						iod,ul_num_buffers = <0x10>;
						iod,ul_buffer_size = <0x800>;
						iod,dl_num_buffers = <0x10>;
						iod,dl_buffer_size = <0x800>;
					};

					io_device_1 {
						iod,name = "umts_ipc0";
						iod,id = <0xeb>;
						iod,format = <0x0>;
						iod,io_type = <0x0>;
						iod,links = <0x200>;
						iod,attrs = <0x82>;
						iod,app = "RIL";
						iod,ul_num_buffers = <0x10>;
						iod,ul_buffer_size = <0x1000>;
						iod,dl_num_buffers = <0x20>;
						iod,dl_buffer_size = <0x1000>;
					};

					io_device_2 {
						iod,name = "umts_ipc1";
						iod,id = <0xec>;
						iod,format = <0x0>;
						iod,io_type = <0x0>;
						iod,links = <0x200>;
						iod,attrs = <0x82>;
						iod,app = "RIL";
						iod,ul_num_buffers = <0x10>;
						iod,ul_buffer_size = <0x1000>;
						iod,dl_num_buffers = <0x20>;
						iod,dl_buffer_size = <0x1000>;
					};

					io_device_3 {
						iod,name = "umts_rfs0";
						iod,id = <0xf5>;
						iod,format = <0x2>;
						iod,io_type = <0x0>;
						iod,links = <0x200>;
						iod,attrs = <0x82>;
						iod,app = "RFS";
						iod,ul_num_buffers = <0x10>;
						iod,ul_buffer_size = <0x800>;
						iod,dl_num_buffers = <0x200>;
						iod,dl_buffer_size = <0x800>;
					};

					io_device_4 {
						iod,name = "umts_csd";
						iod,id = <0x1>;
						iod,format = <0x1>;
						iod,io_type = <0x0>;
						iod,links = <0x200>;
						iod,attrs = <0x82>;
						iod,app = "CSVT";
						iod,ul_num_buffers = <0x20>;
						iod,ul_buffer_size = <0x800>;
						iod,dl_num_buffers = <0x40>;
						iod,dl_buffer_size = <0x800>;
					};

					io_device_5 {
						iod,name = "umts_router";
						iod,id = <0x19>;
						iod,format = <0x1>;
						iod,io_type = <0x0>;
						iod,links = <0x200>;
						iod,attrs = <0x82>;
						iod,app = "Data Router";
						iod,max_tx_size = <0x60e>;
						iod,ul_num_buffers = <0x10>;
						iod,ul_buffer_size = <0x800>;
						iod,dl_num_buffers = <0x10>;
						iod,dl_buffer_size = <0x800>;
					};

					io_device_6 {
						iod,name = "umts_dm0";
						iod,id = <0x1c>;
						iod,format = <0x1>;
						iod,io_type = <0x0>;
						iod,links = <0x200>;
						iod,attrs = <0x82>;
						iod,app = "DIAG";
						iod,ul_num_buffers = <0x10>;
						iod,ul_buffer_size = <0x800>;
						iod,dl_num_buffers = <0x80>;
						iod,dl_buffer_size = <0x800>;
					};

					io_device_7 {
						iod,name = "ipc_loopback0";
						iod,id = <0xf4>;
						iod,format = <0x0>;
						iod,io_type = <0x0>;
						iod,links = <0x200>;
						iod,attrs = <0x82>;
						iod,app = "CLD";
						iod,ul_num_buffers = <0x10>;
						iod,ul_buffer_size = <0x800>;
						iod,dl_num_buffers = <0x20>;
						iod,dl_buffer_size = <0x800>;
					};

					io_device_8 {
						iod,name = "rmnet0";
						iod,id = <0xa>;
						iod,format = <0x1>;
						iod,io_type = <0x1>;
						iod,links = <0x200>;
						iod,attrs = <0x180>;
						iod,app = "NET";
						iod,ul_num_buffers = <0x0>;
						iod,ul_buffer_size = <0x800>;
						iod,dl_num_buffers = <0x0>;
						iod,dl_buffer_size = <0x800>;
					};

					io_device_9 {
						iod,name = "rmnet1";
						iod,id = <0xb>;
						iod,format = <0x1>;
						iod,io_type = <0x1>;
						iod,links = <0x200>;
						iod,attrs = <0x180>;
						iod,app = "NET";
						iod,ul_num_buffers = <0x0>;
						iod,ul_buffer_size = <0x800>;
						iod,dl_num_buffers = <0x0>;
						iod,dl_buffer_size = <0x800>;
					};

					io_device_10 {
						iod,name = "rmnet2";
						iod,id = <0xc>;
						iod,format = <0x1>;
						iod,io_type = <0x1>;
						iod,links = <0x200>;
						iod,attrs = <0x180>;
						iod,app = "NET";
						iod,ul_num_buffers = <0x0>;
						iod,ul_buffer_size = <0x800>;
						iod,dl_num_buffers = <0x0>;
						iod,dl_buffer_size = <0x800>;
					};

					io_device_11 {
						iod,name = "rmnet3";
						iod,id = <0xd>;
						iod,format = <0x1>;
						iod,io_type = <0x1>;
						iod,links = <0x200>;
						iod,attrs = <0x180>;
						iod,app = "NET";
						iod,ul_num_buffers = <0x0>;
						iod,ul_buffer_size = <0x800>;
						iod,dl_num_buffers = <0x0>;
						iod,dl_buffer_size = <0x800>;
					};

					io_device_12 {
						iod,name = "rmnet4";
						iod,id = <0xe>;
						iod,format = <0x1>;
						iod,io_type = <0x1>;
						iod,links = <0x200>;
						iod,attrs = <0x180>;
						iod,ul_num_buffers = <0x0>;
						iod,ul_buffer_size = <0x800>;
						iod,dl_num_buffers = <0x0>;
						iod,dl_buffer_size = <0x800>;
					};

					io_device_13 {
						iod,name = "rmnet5";
						iod,id = <0xf>;
						iod,format = <0x1>;
						iod,io_type = <0x1>;
						iod,links = <0x200>;
						iod,attrs = <0x180>;
						iod,ul_num_buffers = <0x0>;
						iod,ul_buffer_size = <0x800>;
						iod,dl_num_buffers = <0x0>;
						iod,dl_buffer_size = <0x800>;
					};

					io_device_14 {
						iod,name = "rmnet6";
						iod,id = <0x10>;
						iod,format = <0x1>;
						iod,io_type = <0x1>;
						iod,links = <0x200>;
						iod,attrs = <0x180>;
						iod,ul_num_buffers = <0x0>;
						iod,ul_buffer_size = <0x800>;
						iod,dl_num_buffers = <0x0>;
						iod,dl_buffer_size = <0x800>;
					};

					io_device_15 {
						iod,name = "rmnet7";
						iod,id = <0x11>;
						iod,format = <0x1>;
						iod,io_type = <0x1>;
						iod,links = <0x200>;
						iod,attrs = <0x180>;
						iod,ul_num_buffers = <0x0>;
						iod,ul_buffer_size = <0x800>;
						iod,dl_num_buffers = <0x0>;
						iod,dl_buffer_size = <0x800>;
					};

					io_device_16 {
						iod,name = "multipdp_hiprio";
						iod,id = <0x0>;
						iod,format = <0x3>;
						iod,io_type = <0x2>;
						iod,links = <0x200>;
						iod,attrs = <0x180>;
						iod,app = "RIL";
						iod,ul_num_buffers = <0x100>;
						iod,ul_buffer_size = <0x800>;
						iod,dl_num_buffers = <0x100>;
						iod,dl_buffer_size = <0x800>;
					};

					io_device_17 {
						iod,name = "multipdp";
						iod,id = <0x0>;
						iod,format = <0x3>;
						iod,io_type = <0x2>;
						iod,links = <0x200>;
						iod,attrs = <0x180>;
						iod,app = "RIL";
						iod,ul_num_buffers = <0x200>;
						iod,ul_buffer_size = <0x800>;
						iod,dl_num_buffers = <0x400>;
						iod,dl_buffer_size = <0x800>;
					};

					io_device_18 {
						iod,name = "umts_boot0";
						iod,id = <0xd7>;
						iod,format = <0x4>;
						iod,io_type = <0x0>;
						iod,links = <0x200>;
						iod,attrs = <0x2>;
						iod,app = "CBD";
					};

					io_device_19 {
						iod,name = "umts_ramdump0";
						iod,id = <0xe1>;
						iod,format = <0x5>;
						iod,io_type = <0x0>;
						iod,links = <0x200>;
						iod,attrs = <0x202>;
						iod,app = "CBD";
					};

					io_device_20 {
						iod,name = "umts_atc0";
						iod,id = <0x20>;
						iod,format = <0x1>;
						iod,io_type = <0x0>;
						iod,links = <0x200>;
						iod,attrs = <0x882>;
						iod,app = "VCD";
						iod,max_tx_size = <0x800>;
						iod,ul_num_buffers = <0x10>;
						iod,ul_buffer_size = <0x800>;
						iod,dl_num_buffers = <0x80>;
						iod,dl_buffer_size = <0x800>;
						iod,option_region = "usa_vzw";
					};

					io_device_21 {
						iod,name = "smd4";
						iod,id = <0x21>;
						iod,format = <0x1>;
						iod,io_type = <0x0>;
						iod,links = <0x200>;
						iod,attrs = <0x882>;
						iod,ul_num_buffers = <0x10>;
						iod,ul_buffer_size = <0x800>;
						iod,dl_num_buffers = <0x80>;
						iod,dl_buffer_size = <0x800>;
						iod,option_region = "kor_single";
					};

					io_device_22 {
						iod,name = "umts_ciq0";
						iod,id = <0x1a>;
						iod,format = <0x1>;
						iod,io_type = <0x0>;
						iod,links = <0x200>;
						iod,attrs = <0x882>;
						iod,ul_num_buffers = <0x10>;
						iod,ul_buffer_size = <0x800>;
						iod,dl_num_buffers = <0x80>;
						iod,dl_buffer_size = <0x800>;
						iod,option_region = "usa_att";
					};

					io_device_23 {
						iod,name = "umts_mdmi";
						iod,id = <0x22>;
						iod,format = <0x1>;
						iod,io_type = <0x0>;
						iod,links = <0x200>;
						iod,attrs = <0x882>;
						iod,ul_num_buffers = <0x10>;
						iod,ul_buffer_size = <0x800>;
						iod,dl_num_buffers = <0x80>;
						iod,dl_buffer_size = <0x800>;
						iod,option_region = "usa_vzw";
					};
				};
			};

			shmem@F6E00000 {
				compatible = "samsung,exynos-shm_ipc";
				shmem,cp_size = <0x6900000>;
				shmem,vss_size = <0x700000>;
				shmem,ipc_offset = <0x7000000>;
				shmem,ipc_size = <0x800000>;
				linux,phandle = <0x28>;
				phandle = <0x28>;
			};
		};
	};

	fragment@reserved-memory {
		target-path = [2f 00];

		__overlay__ {

			reserved-memory {
				#address-cells = <0x2>;
				#size-cells = <0x1>;
				ranges;

				modem_if {
					compatible = "exynos,modem_if";
					reg = <0x0 0xf5400000 0x7800000>;
				};

				cp_ram_logging {
					compatible = "exynos,cp_ram_logging";
					reg = <0x0 0xfcc00000 0x2000000>;
				};
			};
		};
	};

	fragment@4 {
		target = <0xffffffff>;

		__overlay__ {
			interactive_info = <0x6ddd0 0x5f 0x0>;
			gpu_dvfs_table_size = <0x9 0x7>;
			gpu_dvfs_table = <0x13d620 0x62 0x64 0x1 0x1b5fd0 0x183350 0x0 0x124f80 0x62 0x64 0x1 0x1b5fd0 0x183350 0x0 0x10c8e0 0x5a 0x64 0x1 0x1b5fd0 0x183350 0x0 0xf4628 0x5a 0x5f 0x1 0x1b5fd0 0x183350 0x0 0xce4c8 0x5a 0x5f 0x1 0x14a140 0xb8d08 0x0 0xa50a0 0x5a 0x64 0x1 0x14a140 0xb8d08 0x0 0x850e8 0x5a 0x5f 0x1 0xa50a0 0xb8d08 0x0 0x6ddd0 0x55 0x5f 0x1 0x854d0 0xb8d08 0x0 0x53bd8 0x46 0x5a 0x1 0x668a0 0x6d9e8 0x0>;
			gpu_max_clock = <0xa50a0>;
			gpu_max_clock_limit = <0xa50a0>;
			gpu_temp_throttling_level_num = <0x6>;
			gpu_temp_throttling = <0x850e8 0x6e988 0x53bd8 0x53bd8 0x53bd8 0x53bd8>;
		};
	};

	fragment@5 {
		target = <0xffffffff>;

		__overlay__ {

			fuel-irq {
				samsung,pins = "gpa2-4";
				samsung,pin-function = <0x0>;
				samsung,pin-pud = <0x2>;
				samsung,pin-drv = <0x0>;
				linux,phandle = <0x5>;
				phandle = <0x5>;
			};
		};
	};

	fragment@6 {
		target = <0xffffffff>;

		__overlay__ {
			i2c-gpio,delay-us = <0x5>;
			status = "okay";

			s2mu106-fuelgauge@3B {
				compatible = "samsung,s2mu106-fuelgauge";
				reg = <0x3b>;
				pinctrl-names = "default";
				pinctrl-0 = <0x5>;
				fuelgauge,fuel_int = <0xffffffff 0x4 0x0>;
				fuelgauge,fuel_alert_soc = <0x1>;
				fuelgauge,fuel_alert_vol = <0xce4>;
				fuelgauge,low_temp_limit = <0x64>;
				fuelgauge,low_voltage_limit_lowtemp = <0xbb8>;
				fuelgauge,i_socr_coeff = <0x50>;
				fuelgauge,soc_map_offset = <0x64>;
				fuelgauge,low_t_compen_coeff = <0xb4>;
				fuelgauge,sw_vbat_l_recovery_vol = <0xd89>;
				fuelgauge,capacity_max = <0x3e8>;
				fuelgauge,capacity_max_margin = <0xc8>;
				fuelgauge,capacity_min = <0x0>;
				fuelgauge,capacity_calculation_type = <0x1c>;
				fuelgauge,capacity_full = <0xe10>;
				fuelgauge,type_str = "SDI";
				fuelgauge,fg_log_enable = <0x1>;
				fuelgauge,ttf_capacity = <0xba6>;
				fuelgauge,cv_data = <0x82d 0x369 0x6e0 0x7de 0x370 0x6b7 0x73a 0x37a 0x67a 0x69e 0x385 0x633 0x61e 0x38e 0x5ec 0x58e 0x398 0x59a 0x4fb 0x3a2 0x53f 0x467 0x3ac 0x4d9 0x3df 0x3b6 0x469 0x34e 0x3c0 0x3e5 0x2da 0x3cb 0x34c 0x26d 0x3d4 0x2aa 0x1ff 0x3de 0x1de 0x150 0x3e8 0x0>;
			};
		};
	};

	fragment@battery {
		target-path = [2f 00];

		__overlay__ {

			s2mu106-charger {
				status = "disable";
				compatible = "samsung,s2mu106-charger";
				charger,vsys_factory = <0x1068>;
			};

			battery {
				status = "okay";
				compatible = "samsung,sec-battery";
				pinctrl-names = "default";
				battery,vendor = "Battery";
				battery,charger_name = "s2mu106-charger";
				battery,fuelgauge_name = "s2mu106-fuelgauge";
				battery,technology = <0x2>;
				battery,fgsrc_switch_name = "s2mu106-fuelgauge";
				battery,chip_vendor = "LSI";
				battery,temp_adc_type = <0x1>;
				battery,temp_check_type = <0x2>;
				battery,chg_temp_check = <0x1>;
				battery,thermal_source = <0x2>;
				battery,chg_thermal_source = <0x2>;
				battery,polling_time = <0xa 0x1e 0x1e 0x1e 0xe10>;
				battery,temp_table_adc = <0x153 0x185 0x1bb 0x1d4 0x225 0x27f 0x29a 0x2d2 0x314 0x36a 0x3fb 0x499 0x4fd 0x57c 0x5d5 0x648 0x710 0x80d 0x8da 0x9c3 0xaa7 0xb81 0xc43 0xcef 0xd84 0xe08 0xe76>;
				battery,temp_table_data = <0x384 0x352 0x320 0x2ee 0x2bc 0x28a 0x26c 0x258 0x244 0x226 0x1f4 0x1c2 0x1a4 0x190 0x17c 0x15e 0x12c 0xfa 0xc8 0x96 0x64 0x32 0x0 0xffffffce 0xffffff9c 0xffffff6a 0xffffff38>;
				battery,inbat_voltage = <0x1>;
				battery,inbat_voltage_table_adc = <0xb04 0xaec 0xac3 0xaa8 0xa8a 0xa76 0xa59 0xa3c 0xa26 0xa02 0x9e4 0x9cc 0x9ab 0x990 0x97d 0x961 0x942 0x92c 0x90e 0x8f0 0x8d2>;
				battery,inbat_voltage_table_data = <0x1130 0x10fe 0x10cc 0x109a 0x1068 0x1036 0x1004 0xfd2 0xfa0 0xf6e 0xf3c 0xf0a 0xed8 0xea6 0xe74 0xe42 0xe10 0xdde 0xdac 0xd7a 0xd48>;
				battery,adc_check_count = <0x5>;
				battery,cable_check_type = <0x4>;
				battery,cable_source_type = <0x1>;
				battery,polling_type = <0x1>;
				battery,monitor_initial_count = <0x0>;
				battery,pre_afc_input_current = <0x1f4>;
				battery,battery_check_type = <0x0>;
				battery,check_count = <0x0>;
				battery,ovp_uvlo_check_type = <0x3>;
				battery,temp_check_count = <0x1>;
				battery,temp_highlimit_threshold_event = <0x320>;
				battery,temp_highlimit_recovery_event = <0x2ee>;
				battery,temp_high_threshold_event = <0x1f4>;
				battery,temp_high_recovery_event = <0x1e0>;
				battery,temp_low_threshold_event = <0x0>;
				battery,temp_low_recovery_event = <0x14>;
				battery,temp_highlimit_threshold_normal = <0x320>;
				battery,temp_highlimit_recovery_normal = <0x2ee>;
				battery,temp_high_threshold_normal = <0x1f4>;
				battery,temp_high_recovery_normal = <0x1e0>;
				battery,temp_low_threshold_normal = <0x0>;
				battery,temp_low_recovery_normal = <0x14>;
				battery,temp_highlimit_threshold_lpm = <0x320>;
				battery,temp_highlimit_recovery_lpm = <0x2ee>;
				battery,temp_high_threshold_lpm = <0x1f4>;
				battery,temp_high_recovery_lpm = <0x1e0>;
				battery,temp_low_threshold_lpm = <0x0>;
				battery,temp_low_recovery_lpm = <0x14>;
				battery,wpc_high_threshold_normal = <0x1c2>;
				battery,wpc_high_recovery_normal = <0x190>;
				battery,wpc_low_threshold_normal = <0x0>;
				battery,wpc_low_recovery_normal = <0x32>;
				battery,full_check_type = <0x2>;
				battery,full_check_type_2nd = <0x2>;
				battery,full_check_count = <0x1>;
				battery,chg_gpio_full_check = <0x0>;
				battery,chg_polarity_full_check = <0x1>;
				battery,mix_high_temp = <0x1bd>;
				battery,mix_high_chg_temp = <0x1f4>;
				battery,mix_high_temp_recovery = <0x19f>;
				battery,chg_heating_prevention_method = <0x1>;
				battery,chg_high_temp = <0x1ef>;
				battery,chg_high_temp_recovery = <0x1db>;
				battery,chg_input_limit_current = <0x3e8>;
				battery,chg_charging_limit_current = <0x5dc>;
				battery,full_condition_type = <0xd>;
				battery,full_condition_soc = <0x5d>;
				battery,full_condition_vcell = <0x10b8>;
				battery,recharge_check_count = <0x1>;
				battery,recharge_condition_type = <0x4>;
				battery,recharge_condition_soc = <0x62>;
				battery,recharge_condition_vcell = <0x10d6>;
				battery,charging_total_time = <0x3840>;
				battery,hv_charging_total_time = <0x2a30>;
				battery,normal_charging_total_time = <0x4650>;
				battery,usb_charging_total_time = <0x8ca0>;
				battery,recharging_total_time = <0x1518>;
				battery,charging_reset_time = <0x0>;
				battery,chg_float_voltage = <0x111c>;
				battery,swelling_high_temp_block = <0x1a4>;
				battery,swelling_high_temp_recov = <0x190>;
				battery,swelling_wc_high_temp_recov = <0x186>;
				battery,swelling_low_temp_block_1st = <0x96>;
				battery,swelling_low_temp_recov_1st = <0xaa>;
				battery,swelling_low_temp_block_2nd = <0x32>;
				battery,swelling_low_temp_recov_2nd = <0x46>;
				battery,swelling_low_temp_current = <0x320>;
				battery,swelling_low_temp_current_2nd = <0x12c>;
				battery,swelling_low_temp_topoff = <0xaf>;
				battery,swelling_high_temp_current = <0x4e2>;
				battery,swelling_high_temp_topoff = <0xaf>;
				battery,swelling_drop_float_voltage = <0x1036>;
				battery,swelling_high_rechg_voltage = <0xfa0>;
				battery,swelling_low_rechg_voltage = <0x1086>;
				battery,siop_event_check_type = <0x1>;
				battery,siop_call_cv_current = <0x14a>;
				battery,siop_call_cc_current = <0x14a>;
				battery,siop_input_limit_current = <0x4b0>;
				battery,siop_charging_limit_current = <0x3e8>;
				battery,siop_hv_input_limit_current = <0x2bc>;
				battery,siop_hv_charging_limit_current = <0x3e8>;
				battery,ttf_hv_charge_current = <0x78f>;
				battery,pd_charging_charge_power = <0x3a98>;
				battery,max_charging_current = <0x834>;
				battery,battery_full_capacity = <0xe10>;
				battery,age_data = <0x0 0x111c 0x10d6 0x10b8 0x5d 0x12c 0x1108 0x10c2 0x10a4 0x5c 0x190 0x10f4 0x10ae 0x1090 0x5b 0x2bc 0x10e0 0x109a 0x107c 0x5a 0x3e8 0x10ae 0x1068 0x104a 0x59>;
				battery,health_condition = <0x384 0x4b 0x4b0 0x41 0x5dc 0x37>;
				battery,max_input_voltage = <0x2328>;
				battery,max_input_current = <0xbb8>;
				battery,prepare_afc_delay = <0x0>;
				battery,recovery_cable;
				battery,standard_curr = <0x834>;
				battery,expired_time = <0x2e2c>;
				battery,recharging_expired_time = <0x1518>;
				battery,cisd_max_voltage_thr = <0x1388>;
				battery,cisd_alg_index = <0x7>;
				battery,lowtemp_support_full_volt;
				battery,enable_water_resistance;
				io-channels = <0xffffffff 0x1 0xffffffff 0x2>;
				io-channel-names = "adc-temp", "adc-in-bat";
				#io-channel-cells = <0x5>;
				io-channel-ranges;
			};

			battery_params {
				battery,battery_data = <0x31 0xb 0xae 0xa 0x2b 0xa 0xb3 0x9 0x40 0x9 0xd2 0x8 0x6e 0x8 0x7 0x8 0xb9 0x7 0x63 0x7 0xf6 0x6 0xba 0x6 0x8d 0x6 0x6a 0x6 0x4e 0x6 0x32 0x6 0xb 0x6 0xe2 0x5 0xa2 0x5 0x80 0x5 0xb1 0x4 0x9e 0x1 0x6a 0x8 0x0 0x8 0x96 0x7 0x2c 0x7 0xc3 0x6 0x59 0x6 0xef 0x5 0x85 0x5 0x1b 0x5 0xb2 0x4 0x48 0x4 0xde 0x3 0x74 0x3 0xa 0x3 0xa0 0x2 0x37 0x2 0xcd 0x1 0x63 0x1 0xf9 0x0 0x8f 0x0 0x26 0x0 0xe3 0xf 0xa 0xa 0xa 0xa 0x3f 0x3f 0x3f 0x3e 0x3e 0x3e 0x3e 0x3f 0x40 0x41 0x42 0x43 0x45 0x49 0x50 0x5d 0x74 0xae 0x2a 0x36 0x27 0xa 0x0 0x8 0x2915 0x2710 0x250b 0x2307 0x2102 0x1efd 0x1cf9 0x1af4 0x18ef 0x16eb 0x14e6 0x12e2 0x10dd 0xed8 0xcd4 0xacf 0x8ca 0x6c6 0x4c1 0x2bc 0xb8 0xffffff73 0xabd5 0xa956 0xa6d7 0xa48e 0xa25b 0xa041 0x9e5b 0x9c62 0x9ae5 0x9943 0x972d 0x9608 0x952d 0x9480 0x93fb 0x9370 0x92b1 0x91ea 0x90b3 0x9009 0x8c17 0x7d14 0x0 0x31 0xb 0xae 0xa 0x2b 0xa 0xb3 0x9 0x40 0x9 0xd2 0x8 0x6e 0x8 0x7 0x8 0xb9 0x7 0x63 0x7 0xf6 0x6 0xba 0x6 0x8d 0x6 0x6a 0x6 0x4e 0x6 0x32 0x6 0xb 0x6 0xe2 0x5 0xa2 0x5 0x80 0x5 0xb1 0x4 0x9e 0x1 0x84 0x8 0x19 0x8 0xad 0x7 0x42 0x7 0xd7 0x6 0x6c 0x6 0x1 0x6 0x96 0x5 0x2b 0x5 0xbf 0x4 0x54 0x4 0xe9 0x3 0x7e 0x3 0x13 0x3 0xa8 0x2 0x3d 0x2 0xd1 0x1 0x66 0x1 0xfb 0x0 0x90 0x0 0x25 0x0 0xe2 0xf 0xa 0xa 0xa 0xa 0x3f 0x3f 0x3f 0x3e 0x3e 0x3e 0x3e 0x3f 0x40 0x41 0x42 0x43 0x45 0x49 0x50 0x5d 0x74 0xae 0x30 0x34 0xc9 0x9 0x0 0x8 0x2993 0x2788 0x257d 0x2372 0x2166 0x1f5b 0x1d50 0x1b45 0x193a 0x172f 0x1524 0x1318 0x110d 0xf02 0xcf7 0xaec 0x8e1 0x6d6 0x4ca 0x2bf 0xb4 0xffffff6c 0xabd5 0xa956 0xa6d7 0xa48e 0xa25b 0xa041 0x9e5b 0x9c62 0x9ae5 0x9943 0x972d 0x9608 0x952d 0x9480 0x93fb 0x9370 0x92b1 0x91ea 0x90b3 0x9009 0x8c17 0x7d14 0x0 0x31 0xb 0xae 0xa 0x2b 0xa 0xb3 0x9 0x40 0x9 0xd2 0x8 0x6e 0x8 0x7 0x8 0xb9 0x7 0x63 0x7 0xf6 0x6 0xba 0x6 0x8d 0x6 0x6a 0x6 0x4e 0x6 0x32 0x6 0xb 0x6 0xe2 0x5 0xa2 0x5 0x80 0x5 0xb1 0x4 0x9e 0x1 0xa8 0x8 0x3b 0x8 0xce 0x7 0x61 0x7 0xf4 0x6 0x88 0x6 0x1b 0x6 0xae 0x5 0x41 0x5 0xd4 0x4 0x67 0x4 0xfa 0x3 0x8d 0x3 0x20 0x3 0xb3 0x2 0x46 0x2 0xd9 0x1 0x6c 0x1 0xff 0x0 0x92 0x0 0x26 0x0 0xe1 0xf 0xa 0xa 0xa 0xa 0x3f 0x3f 0x3f 0x3e 0x3e 0x3e 0x3e 0x3f 0x40 0x41 0x42 0x43 0x45 0x49 0x50 0x5d 0x74 0xae 0x54 0x33 0x9f 0x9 0x0 0x8 0x2a45 0x2831 0x261e 0x240a 0x21f6 0x1fe2 0x1dce 0x1bba 0x19a6 0x1792 0x157e 0x136a 0x1156 0xf43 0xd2f 0xb1b 0x907 0x6f3 0x4df 0x2cb 0xb7 0xffffff69 0xabd5 0xa956 0xa6d7 0xa48e 0xa25b 0xa041 0x9e5b 0x9c62 0x9ae5 0x9943 0x972d 0x9608 0x952d 0x9480 0x93fb 0x9370 0x92b1 0x91ea 0x90b3 0x9009 0x8c17 0x7d14 0x0 0x31 0xb 0xae 0xa 0x2b 0xa 0xb3 0x9 0x40 0x9 0xd2 0x8 0x6e 0x8 0x7 0x8 0xb9 0x7 0x63 0x7 0xf6 0x6 0xba 0x6 0x8d 0x6 0x6a 0x6 0x4e 0x6 0x32 0x6 0xb 0x6 0xe2 0x5 0xa2 0x5 0x80 0x5 0xb1 0x4 0x9e 0x1 0xce 0x8 0x5f 0x8 0xf0 0x7 0x82 0x7 0x13 0x7 0xa4 0x6 0x35 0x6 0xc6 0x5 0x58 0x5 0xe9 0x4 0x7a 0x4 0xb 0x4 0x9c 0x3 0x2e 0x3 0xbf 0x2 0x50 0x2 0xe1 0x1 0x73 0x1 0x4 0x1 0x95 0x0 0x26 0x0 0xe1 0xf 0xa 0xa 0xa 0xa 0x3f 0x3f 0x3f 0x3e 0x3e 0x3e 0x3e 0x3f 0x40 0x41 0x42 0x43 0x45 0x49 0x50 0x5d 0x74 0xae 0x78 0x32 0x76 0x9 0x0 0x8 0x2afe 0x28e1 0x26c4 0x24a7 0x228a 0x206d 0x1e50 0x1c33 0x1a16 0x17f9 0x15dc 0x13bf 0x11a2 0xf85 0xd68 0xb4b 0x92e 0x711 0x4f4 0x2d7 0xba 0xffffff67 0xabd5 0xa956 0xa6d7 0xa48e 0xa25b 0xa041 0x9e5b 0x9c62 0x9ae5 0x9943 0x972d 0x9608 0x952d 0x9480 0x93fb 0x9370 0x92b1 0x91ea 0x90b3 0x9009 0x8c17 0x7d14 0x0 0x31 0xb 0xae 0xa 0x2b 0xa 0xb3 0x9 0x40 0x9 0xd2 0x8 0x6e 0x8 0x7 0x8 0xb9 0x7 0x63 0x7 0xf6 0x6 0xba 0x6 0x8d 0x6 0x6a 0x6 0x4e 0x6 0x32 0x6 0xb 0x6 0xe2 0x5 0xa2 0x5 0x80 0x5 0xb1 0x4 0x9e 0x1 0x3c 0x9 0xc8 0x8 0x53 0x8 0xdf 0x7 0x6b 0x7 0xf7 0x6 0x83 0x6 0xf 0x6 0x9a 0x5 0x26 0x5 0xb2 0x4 0x3e 0x4 0xca 0x3 0x55 0x3 0xe1 0x2 0x6d 0x2 0xf9 0x1 0x85 0x1 0x10 0x1 0x9c 0x0 0x28 0x0 0xdf 0xf 0xa 0xa 0xa 0xa 0x3f 0x3f 0x3f 0x3e 0x3e 0x3e 0x3e 0x3f 0x40 0x41 0x42 0x43 0x45 0x49 0x50 0x5d 0x74 0xae 0x20 0x30 0x6 0x9 0x0 0x8 0x2d16 0x2adf 0x28a8 0x2670 0x2439 0x2202 0x1fca 0x1d93 0x1b5c 0x1924 0x16ed 0x14b6 0x127e 0x1047 0xe0f 0xbd8 0x9a1 0x769 0x532 0x2fb 0xc3 0xffffff5f 0xabd5 0xa956 0xa6d7 0xa48e 0xa25b 0xa041 0x9e5b 0x9c62 0x9ae5 0x9943 0x972d 0x9608 0x952d 0x9480 0x93fb 0x9370 0x92b1 0x91ea 0x90b3 0x9009 0x8c17 0x7d14 0x0>;
			};

			cable-info {
				default_input_current = <0x708>;
				default_charging_current = <0x834>;
				full_check_current_1st = <0x15e>;
				full_check_current_2nd = <0xaf>;

				current_group_1 {
					cable_number = <0x2 0x13 0x15 0x16 0x17 0x1e>;
					input_current = <0x1f4>;
					charging_current = <0x1f4>;
				};

				current_group_2 {
					cable_number = <0x19 0x1f>;
					input_current = <0x3e8>;
					charging_current = <0x3e8>;
				};

				current_group_3 {
					cable_number = <0x5 0x20>;
					input_current = <0x5dc>;
					charging_current = <0x5dc>;
				};

				current_group_4 {
					cable_number = <0x6 0x7 0x8 0x11 0x12>;
					input_current = <0x672>;
					charging_current = <0x834>;
				};

				current_group_5 {
					cable_number = <0x9>;
					input_current = <0x672>;
					charging_current = <0x834>;
				};

				current_group_6 {
					cable_number = <0xa 0xc 0xf 0x1b 0x21 0x24>;
					input_current = <0x384>;
					charging_current = <0x4b0>;
				};

				current_group_7 {
					cable_number = <0xd>;
					input_current = <0x2bc>;
					charging_current = <0x4b0>;
				};

				current_group_8 {
					cable_number = <0x18>;
					input_current = <0x3e8>;
					charging_current = <0x1c2>;
				};

				current_group_9 {
					cable_number = <0x1a>;
					input_current = <0x7d0>;
					charging_current = <0x708>;
				};

				current_group_10 {
					cable_number = <0xb 0xe 0x10 0x1c 0x23>;
					input_current = <0x2ee>;
					charging_current = <0x834>;
				};

				current_group_11 {
					cable_number = <0x1d 0x25>;
					input_current = <0x1f4>;
					charging_current = <0x4b0>;
				};

				current_group_12 {
					cable_number = <0x1 0x4>;
					input_current = <0x1db>;
					charging_current = <0x226>;
				};

				current_group_14 {
					cable_number = <0x22>;
					input_current = <0x4b0>;
					charging_current = <0x834>;
				};
			};
		};
	};

	fragment@motor {
		target-path = [2f 00];

		__overlay__ {

			s2mu106-haptic {
				status = "okay";
				haptic,operation_mode = <0x1>;
				haptic,max_timeout = <0x2710>;
				haptic,type = "COINDC";
				haptic,motor_en = <0xffffffff 0x3 0x1>;
			};
		};
	};

	fragment@common {
		target-path = [2f 00];

		__overlay__ {
			#address-cells = <0x2>;
			#size-cells = <0x1>;

			argos {
				compatible = "samsung,argos";
				#address-cells = <0x1>;

				boot_device@1 {
					net_boost,label = "IPC";
					net_boost,node = "rmnet0 rmnet1 rmnet2 rmnet3 rmnet4 rmnet5 rmnet6 rmnet7 umts_dm0";

					net_boost,table {

						level_0 {
							threshold = <0x1>;
							irq_affinity = "enable";
						};

						level_1 {
							threshold = <0x32>;
							lit_min = <0x11da50>;
							mif = <0x1174c0>;
							irq_affinity = "enable";
						};

						level_2 {
							threshold = <0x64>;
							lit_min = <0x1506d0>;
							mif = <0x177bb8>;
							irq_affinity = "enable";
						};

						level_3 {
							threshold = <0x96>;
							lit_min = <0x183350>;
							mif = <0x1b5fd0>;
							irq_affinity = "enable";
						};
					};
				};

				boot_device@2 {
					net_boost,label = "CLAT";
					net_boost,node = "clat clat4 v4-rmnet0 v4-rmnet1 v4-rmnet2 v4-rmnet3 v4-rmnet4 v4-rmnet5 v4-rmnet6 v4-rmnet7";

					net_boost,table {

						level_0 {
							threshold = <0x14>;
							lit_min = <0x11da50>;
							mif = <0x177bb8>;
						};

						level_1 {
							threshold = <0x32>;
							lit_min = <0x1506d0>;
							mif = <0x177bb8>;
						};

						level_2 {
							threshold = <0x64>;
							lit_min = <0x183350>;
							mif = <0x1b5fd0>;
						};
					};
				};

				boot_device@3 {
					net_boost,label = "WIFI TX";
					net_boost,node = "wlan0";

					net_boost,table {

						level_0 {
							threshold = <0x3c>;
							big_min = <0x1174c0>;
							lit_min = <0xa50a0>;
							int = <0x61a80>;
						};

						level_1 {
							threshold = <0x78>;
							big_min = <0x17cdc0>;
							lit_min = <0x183350>;
						};
					};
				};

				boot_device@4 {
					net_boost,label = "WIFI RX";
					net_boost,node = "wlan0";

					net_boost,table {

						level_0 {
							threshold = <0xb4>;
							big_min = <0x14a140>;
							lit_min = <0x14a140>;
						};
					};
				};

				boot_device@5 {
					net_boost,label = "USB";
					net_boost,node = "rndis0";

					net_boost,table {

						level_0 {
							threshold = <0x0>;
							irq_affinity = "enable";
						};
					};
				};
			};
		};
	};

	fragment@camera {
		target-path = [2f 00];

		__overlay__ {

			fimc-is_sensor_3l6@5A {
				compatible = "samsung,sensor-module-3l6";
				pinctrl-names = "pin0", "pin1", "pin2", "release";
				pinctrl-0;
				pinctrl-1 = <0xffffffff>;
				pinctrl-2 = <0xffffffff>;
				pinctrl-3;
				position = <0x0>;
				id = <0x0>;
				mclk_ch = <0x2>;
				num_of_lanes = <0x4>;
				gpio_mclk = <0xffffffff 0x2 0x1>;
				gpio_reset = <0xffffffff 0x4 0x1>;
				gpio_cam_ldo_en = <0xffffffff 0x4 0x1>;
				common_rcam_ldo_en;
				gpio_camio_1p8_en = <0xffffffff 0x7 0x1>;
				status = "okay";
				linux,phandle = <0x29>;
				phandle = <0x29>;

				af {
					product_name = <0x13>;
					i2c_addr = <0x18>;
					i2c_ch = <0x3>;
				};

				flash {
					product_name = <0xe>;
				};
			};

			fimc-is_sensor_5e9@23 {
				compatible = "samsung,sensor-module-5e9";
				pinctrl-names = "pin0", "pin1", "pin2", "release";
				pinctrl-0 = <0xffffffff>;
				pinctrl-1 = <0xffffffff>;
				pinctrl-2 = <0xffffffff>;
				pinctrl-3;
				position = <0x1>;
				id = <0x1>;
				mclk_ch = <0x1>;
				gpio_mclk = <0xffffffff 0x1 0x1>;
				gpio_reset = <0xffffffff 0x5 0x1>;
				gpio_camio_1p8_en = <0xffffffff 0x7 0x1>;
				gpio_cam_core_en = <0xffffffff 0x4 0x1>;
				status = "okay";
				linux,phandle = <0x2a>;
				phandle = <0x2a>;
			};

			fimc-is-flash_gpio@0 {
				compatible = "samsung,sensor-flash-s2mu106";
				id = <0x0>;
				status = "okay";
				flash-gpio = <0xffffffff 0x7 0x0>;
				torch-gpio = <0xffffffff 0x1 0x0>;
				linux,phandle = <0x2b>;
				phandle = <0x2b>;
			};
		};
	};

	fragment@7 {
		target = <0xffffffff>;

		__overlay__ {
			pinctrl-names = "default", "release";
			pinctrl-0 = <0xffffffff 0xffffffff>;
			pinctrl-1;

			vender {
				rear_sensor_id = <0x3b>;
				front_sensor_id = <0x29>;
				use_module_check;
				max_supported_camera = <0x2>;
				supported_cameraId = <0x0 0x1>;
				max_camera_num = <0x2>;

				camera_info0 {
					isp = <0x0>;
					cal_memory = <0x2>;
					read_version = <0x0>;
					core_voltage = <0x0>;
					upgrade = <0x0>;
					companion = <0x0>;
					ois = <0x0>;
					valid = <0x1>;
					dual_open = <0x0>;
					position = <0x0>;
				};

				camera_info1 {
					isp = <0x0>;
					cal_memory = <0x3>;
					read_version = <0x0>;
					core_voltage = <0x0>;
					upgrade = <0x0>;
					companion = <0x0>;
					ois = <0x0>;
					valid = <0x1>;
					dual_open = <0x0>;
					position = <0x1>;
				};
			};

			fimc_is_dvfs {

				table0 {
					desc = "default";
					default_int = <0x1a1f8>;
					default_cam = <0xa8750>;
					default_mif = <0x1fefc8>;
					default_i2c = <0x0>;
					front_preview_int = <0x1a1f8>;
					front_preview_cam = <0xa3930>;
					front_preview_mif = <0xf78f0>;
					front_preview_i2c = <0x0>;
					front_capture_int = <0x1a1f8>;
					front_capture_cam = <0xa3930>;
					front_capture_mif = <0xf78f0>;
					front_capture_i2c = <0x0>;
					front_video_int = <0x1a1f8>;
					front_video_cam = <0xa3930>;
					front_video_mif = <0xf78f0>;
					front_video_i2c = <0x0>;
					front_vt1_int = <0x1a1f8>;
					front_vt1_cam = <0xa1220>;
					front_vt1_mif = <0xa50a0>;
					front_vt1_i2c = <0x0>;
					front_vt2_int = <0x1a1f8>;
					front_vt2_cam = <0xa1220>;
					front_vt2_mif = <0xa50a0>;
					front_vt2_i2c = <0x0>;
					front_vt4_int = <0x1a1f8>;
					front_vt4_cam = <0xa1220>;
					front_vt4_mif = <0xa50a0>;
					front_vt4_i2c = <0x0>;
					rear_preview_fhd_int = <0x1a1f8>;
					rear_preview_fhd_cam = <0xa3930>;
					rear_preview_fhd_mif = <0x14a140>;
					rear_preview_fhd_i2c = <0x0>;
					rear_capture_int = <0x1a1f8>;
					rear_capture_cam = <0xa6040>;
					rear_capture_mif = <0x177bb8>;
					rear_capture_i2c = <0x0>;
					rear_video_fhd_int = <0x1a1f8>;
					rear_video_fhd_cam = <0xa3930>;
					rear_video_fhd_mif = <0x14a140>;
					rear_video_fhd_i2c = <0x0>;
					rear_video_fhd_capture_int = <0x1a1f8>;
					rear_video_fhd_capture_cam = <0xa6040>;
					rear_video_fhd_capture_mif = <0x177bb8>;
					rear_video_fhd_capture_i2c = <0x0>;
					preview_high_speed_fps_int = <0x1a1f8>;
					preview_high_speed_fps_cam = <0xa3930>;
					preview_high_speed_fps_mif = <0xf78f0>;
					preview_high_speed_fps_i2c = <0x0>;
					video_high_speed_60fps_int = <0x1a1f8>;
					video_high_speed_60fps_cam = <0xa3930>;
					video_high_speed_60fps_mif = <0xf78f0>;
					video_high_speed_60fps_i2c = <0x0>;
					video_high_speed_120fps_int = <0x1a1f8>;
					video_high_speed_120fps_cam = <0xa3930>;
					video_high_speed_120fps_mif = <0xf78f0>;
					video_high_speed_120fps_i2c = <0x0>;
					max_int = <0x1a1f8>;
					max_cam = <0xa8750>;
					max_mif = <0x1fefc8>;
					max_i2c = <0x0>;
				};

				table1 {
					desc = "DVFS table for HAL3";
					default_int = <0x1a1f8>;
					default_cam = <0xa8750>;
					default_mif = <0x1fefc8>;
					default_i2c = <0x0>;
					front_preview_int = <0x1a1f8>;
					front_preview_cam = <0xa3930>;
					front_preview_mif = <0xf78f0>;
					front_preview_i2c = <0x0>;
					front_capture_int = <0x1a1f8>;
					front_capture_cam = <0xa3930>;
					front_capture_mif = <0xf78f0>;
					front_capture_i2c = <0x0>;
					front_video_int = <0x1a1f8>;
					front_video_cam = <0xa3930>;
					front_video_mif = <0xf78f0>;
					front_video_i2c = <0x0>;
					front_vt1_int = <0x1a1f8>;
					front_vt1_cam = <0xa1220>;
					front_vt1_mif = <0xf78f0>;
					front_vt1_i2c = <0x0>;
					front_vt2_int = <0x1a1f8>;
					front_vt2_cam = <0xa1220>;
					front_vt2_mif = <0xf78f0>;
					front_vt2_i2c = <0x0>;
					front_vt4_int = <0x1a1f8>;
					front_vt4_cam = <0xa1220>;
					front_vt4_mif = <0xf78f0>;
					front_vt4_i2c = <0x0>;
					rear_preview_fhd_int = <0x1a1f8>;
					rear_preview_fhd_cam = <0xa8750>;
					rear_preview_fhd_mif = <0x1b5fd0>;
					rear_preview_fhd_i2c = <0x0>;
					rear_capture_int = <0x1a1f8>;
					rear_capture_cam = <0xa8750>;
					rear_capture_mif = <0x1b5fd0>;
					rear_capture_i2c = <0x0>;
					rear_video_fhd_int = <0x1a1f8>;
					rear_video_fhd_cam = <0xa8750>;
					rear_video_fhd_mif = <0x1b5fd0>;
					rear_video_fhd_i2c = <0x0>;
					rear_video_uhd_int = <0x1a1f8>;
					rear_video_uhd_cam = <0xa3930>;
					rear_video_uhd_mif = <0x1e8c50>;
					rear_video_uhd_i2c = <0x0>;
					rear_video_fhd_capture_int = <0x1a1f8>;
					rear_video_fhd_capture_cam = <0xa6040>;
					rear_video_fhd_capture_mif = <0x177bb8>;
					rear_video_fhd_capture_i2c = <0x0>;
					rear_video_uhd_capture_int = <0x1a1f8>;
					rear_video_uhd_capture_cam = <0xa8750>;
					rear_video_uhd_capture_mif = <0x1fefc8>;
					rear_video_uhd_capture_i2c = <0x0>;
					dual_preview_int = <0x1a1f8>;
					dual_preview_cam = <0xa8750>;
					dual_preview_mif = <0x14a140>;
					dual_preview_i2c = <0x0>;
					dual_capture_int = <0x1a1f8>;
					dual_capture_cam = <0xa8750>;
					dual_capture_mif = <0x14a140>;
					dual_capture_i2c = <0x0>;
					dual_video_int = <0x1a1f8>;
					dual_video_cam = <0xa8750>;
					dual_video_mif = <0x14a140>;
					dual_video_i2c = <0x0>;
					preview_high_speed_fps_int = <0x1a1f8>;
					preview_high_speed_fps_cam = <0xa3930>;
					preview_high_speed_fps_mif = <0xf78f0>;
					preview_high_speed_fps_i2c = <0x0>;
					video_high_speed_60fps_int = <0x1a1f8>;
					video_high_speed_60fps_cam = <0xa1220>;
					video_high_speed_60fps_mif = <0xf78f0>;
					video_high_speed_60fps_i2c = <0x0>;
					video_high_speed_120fps_int = <0x1a1f8>;
					video_high_speed_120fps_cam = <0xa3930>;
					video_high_speed_120fps_mif = <0xf78f0>;
					video_high_speed_120fps_i2c = <0x0>;
					max_int = <0x1a1f8>;
					max_cam = <0xa8750>;
					max_mif = <0x1fefc8>;
					max_i2c = <0x0>;
				};
			};
		};
	};

	fragment@8 {
		target = <0xffffffff>;

		__overlay__ {
			scenario = <0x0>;
			id = <0x0>;
			csi_ch = <0x1>;
			flite_ch = <0x64>;
			is_bns = <0x0>;
			is_flite = <0x0>;
			status = "okay";
		};
	};

	fragment@9 {
		target = <0xffffffff>;

		__overlay__ {
			scenario = <0x0>;
			id = <0x1>;
			csi_ch = <0x0>;
			flite_ch = <0x64>;
			is_bns = <0x0>;
			is_flite = <0x0>;
			status = "okay";
		};
	};

	fragment@10 {
		target = <0xffffffff>;

		__overlay__ {
			scenario = <0x0>;
			id = <0x3>;
			csi_ch = <0x2>;
			flite_ch = <0x64>;
			is_bns = <0x0>;
			is_flite = <0x0>;
			status = "disabled";
		};
	};

	fragment@11 {
		target = <0xffffffff>;

		__overlay__ {
			scenario = <0x0>;
			id = <0x2>;
			csi_ch = <0x3>;
			flite_ch = <0x64>;
			is_bns = <0x0>;
			is_flite = <0x0>;
			status = "disabled";
		};
	};

	fragment@12 {
		target = <0xffffffff>;

		__overlay__ {
			#address-cells = <0x1>;
			#size-cells = <0x0>;
			gpios = <0xffffffff 0x0 0x0 0xffffffff 0x1 0x0>;
			status = "okay";
			clock-frequency = <0x61a80>;
			samsung,scl-extended-low-period;
			samsung,reset-before-trans;
			pinctrl-names = "on_i2c";
			pinctrl-0 = <0xffffffff>;

			fimc-is-5e9@2d {
				compatible = "samsung,exynos5-fimc-is-cis-5e9";
				reg = <0x2d>;
				id = <0x1>;
				sensor_f_number = <0xc8>;
				setfile = "setB";
				use_sensor_otp;
				rom_position = <0x1>;
				use_initial_ae;
			};
		};
	};

	fragment@13 {
		target = <0xffffffff>;

		__overlay__ {
			#address-cells = <0x1>;
			#size-cells = <0x0>;
			gpios = <0xffffffff 0x2 0x0 0xffffffff 0x3 0x0>;
			status = "okay";
			clock-frequency = <0x61a80>;
			samsung,scl-extended-low-period;
			samsung,reset-before-trans;
			pinctrl-names = "on_i2c";
			pinctrl-0 = <0xffffffff>;

			fimc-is-3l6@2D {
				compatible = "samsung,exynos5-fimc-is-cis-3l6";
				reg = <0x2d>;
				id = <0x0>;
				sensor_f_number = <0xbe>;
				num_of_lanes = <0x4>;
				setfile = "setB";
			};
		};
	};

	fragment@14 {
		target = <0xffffffff>;

		__overlay__ {
			#address-cells = <0x1>;
			#size-cells = <0x0>;
			gpios = <0xffffffff 0x4 0x0 0xffffffff 0x5 0x0>;
			status = "disabled";
			clock-frequency = <0x61a80>;
			samsung,scl-extended-low-period;
			samsung,reset-before-trans;
			pinctrl-names = "on_i2c";
			pinctrl-0 = <0xffffffff>;
		};
	};

	fragment@15 {
		target = <0xffffffff>;

		__overlay__ {
			#address-cells = <0x1>;
			#size-cells = <0x0>;
			gpios = <0xffffffff 0x6 0x0 0xffffffff 0x7 0x0>;
			status = "okay";
			clock-frequency = <0x61a80>;
			samsung,scl-extended-low-period;
			samsung,reset-before-trans;
			pinctrl-names = "on_i2c";
			pinctrl-0 = <0xffffffff>;

			fimc-is-actuator@18 {
				compatible = "samsung,exynos5-fimc-is-actuator-dw9808";
				reg = <0xc>;
				id = <0x0>;
				place = <0x0>;
			};

			rear_eeprom@B0 {
				compatible = "samsung,rear-eeprom-i2c";
				reg = <0x58>;
			};
		};
	};

	fragment@16 {
		target = <0xffffffff>;

		__overlay__ {

			flash_off_state {
				samsung,pins = "gpg0-1";
				samsung,pin-con-pdn = <0x3>;
				samsung,pin-pud-pdn = <0x0>;
				linux,phandle = <0x6>;
				phandle = <0x6>;
			};
		};
	};

	fragment@17 {
		target = <0xffffffff>;

		__overlay__ {

			s2mu106@3D {
				reg = <0x3d>;

				flash_led {
					status = "okay";
					pinctrl-names = "default", "flash_suspend";
					pinctrl-0;
					pinctrl-1 = <0x6>;
					default_current = <0x32>;
					max_current = <0xc8>;
					default_timer = <0x0>;
					flash-gpio = <0xffffffff 0x7 0x0>;
					torch-gpio = <0xffffffff 0x1 0x0>;
					flash_current = <0x5dc>;
					preflash_current = <0xaf>;
					movie_current = <0x3c>;
					torch_current = <0x4b>;
					factory_current = <0x96>;
					flashlight_current = <0x1e 0x46 0x69 0x96 0xd2>;
				};
			};
		};
	};

	fragment@abc {
		target-path = [2f 00];

		__overlay__ {

			sec_abc {
				compatible = "samsung,sec_abc";
				status = "okay";

				gpu {
					gpu,label = "GPU fault";
					gpu,threshold_count = <0x4>;
					gpu,threshold_time = <0x4b0>;
				};

				aicl {
					aicl,label = "battery aicl";
					aicl,threshold_count = <0x5>;
					aicl,threshold_time = <0x12c>;
				};
			};

			abc_hub {
				compatible = "samsung,abc_hub";
				status = "okay";

				bootc {
					bootc,time_spec_user = <0x186a0>;
					bootc,time_spec_eng = <0x186a0>;
					bootc,time_spec_fac = <0x186a0>;
				};
			};
		};
	};

	fragment@model {
		target-path = [2f 00];

		__overlay__ {
			#address-cells = <0x2>;
			#size-cells = <0x1>;
			model = "Samsung A10EU JPN DCM 01 based on EXYNOS7884B";

			memory@880000000 {
				device_type = "memory";
				reg = <0x8 0x80000000 0x40000000>;
			};

			fixed-rate-clocks {

				oscclk {
					compatible = "samsung,exynos7885-oscclk";
					clock-frequency = <0x18cba80>;
				};
			};

			firmware {

				android {
					compatible = "android,firmware";
					linux,phandle = <0x2c>;
					phandle = <0x2c>;

					vbmeta {
						compatible = "android,vbmeta";
						parts = "vbmeta,boot,system,vendor,product,odm,prism,optics,vbmeta_samsung,recovery,dtbo,keystorage";
					};
				};
			};

			exynos_rgt {
				compatible = "samsung,exynos-rgt";
			};

			gpio_keys {
				status = "okay";
				compatible = "gpio-keys";
				#address-cells = <0x1>;
				#size-cells = <0x0>;
				pinctrl-names = "default";
				pinctrl-0 = <0x7 0x8 0x9>;

				button@2 {
					label = "gpio-keys: KEY_VOLUMEDOWN";
					interrupts = <0x6 0x0 0x0>;
					interrupt-parent = <0xffffffff>;
					linux,code = <0x72>;
					gpios = <0xffffffff 0x6 0xf>;
				};

				button@3 {
					label = "gpio-keys: KEY_VOLUMEUP";
					interrupts = <0x5 0x0 0x0>;
					interrupt-parent = <0xffffffff>;
					linux,code = <0x73>;
					gpios = <0xffffffff 0x5 0xf>;
				};

				button@4 {
					label = "gpio-keys: KEY_POWER";
					interrupts = <0x7 0x0 0x0>;
					interrupt-parent = <0xffffffff>;
					linux,code = <0x74>;
					gpios = <0xffffffff 0x7 0xf>;
					gpio-key,wakeup = <0x1>;
				};
			};

			usi@10032004 {
				usi_mode = "spi";
				status = "okay";
			};

			usi@10032008 {
				usi_mode = "spi";
				status = "okay";
			};

			but_zones {
				#list-but-cells = <0x3>;
				linux,phandle = <0xb>;
				phandle = <0xb>;
			};

			speedy@11CE0000 {
				#address-cells = <0x1>;
				#size-cells = <0x0>;
				status = "okay";
				linux,phandle = <0x2d>;
				phandle = <0x2d>;

				cod3035x@03 {
					compatible = "codec,cod3035x";
					#sound-dai-cells = <0x1>;
					reg = <0x3>;
					i2c-speedy-address;
					vdd-supply = <0xa>;
					pinctrl-names = "default";
					mic-bias1-voltage = <0x1>;
					mic-bias2-voltage = <0x1>;
					mic-bias-ldo-voltage = <0x3>;
					use-lassenA;
					use-btn-adc-mode;
					use-det-gdet-adc-mode = <0x1>;
					water-threshold-max = <0xaf1>;
					water-threshold-min = <0x11e>;
					aux-cable-detect-adc = <0xff>;
					fake-jack-adc = <0xfd>;
					jackin-dbnc-time = <0xc0>;
					jackout-dbnc-time = <0x2>;
					jack-imp-tuning = <0x9>;
					io-channels = <0xffffffff 0x3 0xffffffff 0x7>;
					io-channel-names = "adc-ear", "adc-gdet";
					#io-channel-cells = <0x1>;
					rcv-drv-current = <0x1>;
					io-channel-ranges;
					but-zones-list = <0xb 0xe2 0x0 0x178 0xb 0x246 0x179 0x1bf 0xb 0x73 0x1c0 0x273 0xb 0x72 0x274 0x489>;
					mic-adc-range = <0x57c>;
					btn-release-value = <0x57c>;
					use-feature-flag = <0x0>;
					linux,phandle = <0xc>;
					phandle = <0xc>;
				};

				s2mpu08mfd@00 {
					samsung,codec-interrupt = <0xc>;
					compatible = "samsung,s2mpu08mfd";
					acpm-ipc-channel = <0x2>;
					i2c-speedy-address;
					s2mpu08,wakeup = "enabled";
					s2mpu08,irq-gpio = <0xffffffff 0x0 0x0>;
					reg = <0x0>;
					interrupts = <0x2 0x0 0x0>;
					interrupt-parent = <0xffffffff>;
					pinctrl-names = "default";
					pinctrl-0 = <0xd 0xe>;
					wtsr_en = "enabled";
					smpl_en = "enabled";
					wtsr_timer_val = <0x3>;
					smpl_timer_val = <0x0>;
					check_jigon = <0x0>;
					init_time,sec = <0x0>;
					init_time,min = <0x0>;
					init_time,hour = <0xc>;
					init_time,mday = <0x1>;
					init_time,mon = <0x0>;
					init_time,year = <0x78>;
					init_time,wday = <0x3>;

					regulators {

						BUCK1 {
							regulator-name = "vdd_mif";
							regulator-min-microvolt = <0x7a120>;
							regulator-max-microvolt = <0x10c8e0>;
							regulator-always-on;
							regulator-ramp-delay = <0x2ee0>;
							regulator-initial-mode = <0x2>;
							linux,phandle = <0x2e>;
							phandle = <0x2e>;
						};

						BUCK2 {
							regulator-name = "vdd_cpucl0";
							regulator-min-microvolt = <0x7a120>;
							regulator-max-microvolt = <0x13d620>;
							regulator-always-on;
							regulator-ramp-delay = <0x2ee0>;
							regulator-initial-mode = <0x1>;
							linux,phandle = <0x2f>;
							phandle = <0x2f>;
						};

						BUCK3 {
							regulator-name = "vdd_cpucl1_2";
							regulator-min-microvolt = <0x7a120>;
							regulator-max-microvolt = <0x13d620>;
							regulator-always-on;
							regulator-ramp-delay = <0x2ee0>;
							regulator-initial-mode = <0x1>;
							linux,phandle = <0x30>;
							phandle = <0x30>;
						};

						BUCK4 {
							regulator-name = "vdd_int";
							regulator-min-microvolt = <0x7a120>;
							regulator-max-microvolt = <0x124f80>;
							regulator-always-on;
							regulator-ramp-delay = <0x2ee0>;
							regulator-initial-mode = <0x2>;
							linux,phandle = <0x31>;
							phandle = <0x31>;
						};

						BUCK5 {
							regulator-name = "vdd_g3d";
							regulator-min-microvolt = <0x7a120>;
							regulator-max-microvolt = <0x13d620>;
							regulator-always-on;
							regulator-ramp-delay = <0x2ee0>;
							regulator-initial-mode = <0x1>;
							linux,phandle = <0x32>;
							phandle = <0x32>;
						};

						BUCK6 {
							regulator-name = "vdd2_mem";
							regulator-min-microvolt = <0x7a120>;
							regulator-max-microvolt = <0x13d620>;
							regulator-always-on;
							regulator-ramp-delay = <0x2ee0>;
							regulator-initial-mode = <0x3>;
							linux,phandle = <0x33>;
							phandle = <0x33>;
						};

						BUCK7 {
							regulator-name = "vdd_lldo";
							regulator-min-microvolt = <0x124f80>;
							regulator-max-microvolt = <0x16e360>;
							regulator-always-on;
							regulator-ramp-delay = <0x2ee0>;
							regulator-initial-mode = <0x3>;
							linux,phandle = <0x34>;
							phandle = <0x34>;
						};

						BUCK8 {
							regulator-name = "vdd_mldo";
							regulator-min-microvolt = <0x1b7740>;
							regulator-max-microvolt = <0x200b20>;
							regulator-always-on;
							regulator-ramp-delay = <0x2ee0>;
							regulator-initial-mode = <0x3>;
							linux,phandle = <0x35>;
							phandle = <0x35>;
						};

						LDO1 {
							regulator-name = "vdd_ldo1";
							regulator-min-microvolt = <0xaae60>;
							regulator-max-microvolt = <0x13d620>;
							regulator-always-on;
							regulator-ramp-delay = <0x2ee0>;
							regulator-initial-mode = <0x3>;
							linux,phandle = <0x36>;
							phandle = <0x36>;
						};

						LDO2 {
							regulator-name = "vqmmc";
							regulator-min-microvolt = <0x1b7740>;
							regulator-max-microvolt = <0x2d0370>;
							regulator-ramp-delay = <0x2ee0>;
							linux,phandle = <0x37>;
							phandle = <0x37>;
						};

						LDO3 {
							regulator-name = "vdd_ldo3";
							regulator-min-microvolt = <0xc3500>;
							regulator-max-microvolt = <0x1dc130>;
							regulator-always-on;
							regulator-ramp-delay = <0x2ee0>;
							regulator-initial-mode = <0x3>;
							linux,phandle = <0x38>;
							phandle = <0x38>;
						};

						LDO4 {
							regulator-name = "vdd_ldo4";
							regulator-min-microvolt = <0x7a120>;
							regulator-max-microvolt = <0x13d620>;
							regulator-always-on;
							regulator-ramp-delay = <0x2ee0>;
							regulator-initial-mode = <0x1>;
							linux,phandle = <0x39>;
							phandle = <0x39>;
						};

						LDO5 {
							regulator-name = "vdd_ldo5";
							regulator-min-microvolt = <0xc3500>;
							regulator-max-microvolt = <0x149970>;
							regulator-always-on;
							regulator-ramp-delay = <0x2ee0>;
							regulator-initial-mode = <0x1>;
							linux,phandle = <0x3a>;
							phandle = <0x3a>;
						};

						LDO6 {
							regulator-name = "vdd_ldo6";
							regulator-min-microvolt = <0xc3500>;
							regulator-max-microvolt = <0x149970>;
							regulator-always-on;
							regulator-ramp-delay = <0x2ee0>;
							regulator-initial-mode = <0x1>;
							linux,phandle = <0x3b>;
							phandle = <0x3b>;
						};

						LDO7 {
							regulator-name = "vdd_ldo7";
							regulator-min-microvolt = <0xc3500>;
							regulator-max-microvolt = <0x1dc130>;
							regulator-always-on;
							regulator-ramp-delay = <0x2ee0>;
							regulator-initial-mode = <0x1>;
							linux,phandle = <0x3c>;
							phandle = <0x3c>;
						};

						LDO8 {
							regulator-name = "vdd_ldo8";
							regulator-min-microvolt = <0x7a120>;
							regulator-max-microvolt = <0x13d620>;
							regulator-always-on;
							regulator-ramp-delay = <0x2ee0>;
							regulator-initial-mode = <0x1>;
							linux,phandle = <0x3d>;
							phandle = <0x3d>;
						};

						LDO9 {
							regulator-name = "vdd_ldo9";
							regulator-min-microvolt = <0x7a120>;
							regulator-max-microvolt = <0x13d620>;
							regulator-always-on;
							regulator-ramp-delay = <0x2ee0>;
							regulator-initial-mode = <0x1>;
							linux,phandle = <0x3e>;
							phandle = <0x3e>;
						};

						LDO10 {
							regulator-name = "vdd_ldo10";
							regulator-min-microvolt = <0x7a120>;
							regulator-max-microvolt = <0x13d620>;
							regulator-always-on;
							regulator-ramp-delay = <0x2ee0>;
							regulator-initial-mode = <0x1>;
							linux,phandle = <0x3f>;
							phandle = <0x3f>;
						};

						LDO11 {
							regulator-name = "vdd_ldo11";
							regulator-min-microvolt = <0x7a120>;
							regulator-max-microvolt = <0x13d620>;
							regulator-always-on;
							regulator-ramp-delay = <0x2ee0>;
							regulator-initial-mode = <0x1>;
							linux,phandle = <0x40>;
							phandle = <0x40>;
						};

						LDO12 {
							regulator-name = "vdd_ldo12";
							regulator-min-microvolt = <0xc3500>;
							regulator-max-microvolt = <0x149970>;
							regulator-always-on;
							regulator-ramp-delay = <0x2ee0>;
							regulator-initial-mode = <0x1>;
							linux,phandle = <0x41>;
							phandle = <0x41>;
						};

						LDO13 {
							regulator-name = "vdd_ldo13";
							regulator-min-microvolt = <0xc3500>;
							regulator-max-microvolt = <0x1dc130>;
							regulator-always-on;
							regulator-ramp-delay = <0x2ee0>;
							regulator-initial-mode = <0x1>;
							linux,phandle = <0x42>;
							phandle = <0x42>;
						};

						LDO14 {
							regulator-name = "vdd_ldo14";
							regulator-min-microvolt = <0x1b7740>;
							regulator-max-microvolt = <0x337f98>;
							regulator-always-on;
							regulator-ramp-delay = <0x2ee0>;
							regulator-initial-mode = <0x1>;
							linux,phandle = <0x43>;
							phandle = <0x43>;
						};

						LDO33 {
							regulator-name = "vdd_ldo33";
							regulator-min-microvolt = <0xc3500>;
							regulator-max-microvolt = <0x1dc130>;
							regulator-always-on;
							regulator-ramp-delay = <0x2ee0>;
							regulator-initial-mode = <0x3>;
							linux,phandle = <0x44>;
							phandle = <0x44>;
						};

						LDO34 {
							regulator-name = "vdd_ldo34";
							regulator-min-microvolt = <0x1b7740>;
							regulator-max-microvolt = <0x337f98>;
							regulator-always-on;
							regulator-ramp-delay = <0x2ee0>;
							regulator-initial-mode = <0x3>;
							linux,phandle = <0x45>;
							phandle = <0x45>;
						};

						LDO35 {
							regulator-name = "vmmc";
							regulator-min-microvolt = <0x1b7740>;
							regulator-max-microvolt = <0x2d0370>;
							regulator-ramp-delay = <0x2ee0>;
							linux,phandle = <0x46>;
							phandle = <0x46>;
						};

						LDO36 {
							regulator-name = "vdd_ldo36";
							regulator-min-microvolt = <0xc3500>;
							regulator-max-microvolt = <0x1dc130>;
							regulator-always-on;
							regulator-ramp-delay = <0x2ee0>;
							regulator-initial-mode = <0x3>;
							linux,phandle = <0xa>;
							phandle = <0xa>;
						};

						LDO37 {
							regulator-name = "vdd_ldo37";
							regulator-min-microvolt = <0x1b7740>;
							regulator-max-microvolt = <0x337f98>;
							regulator-always-on;
							regulator-ramp-delay = <0x2ee0>;
							regulator-initial-mode = <0x3>;
							linux,phandle = <0x47>;
							phandle = <0x47>;
						};
					};
				};
			};

			hs_tune {
				hs_tune_cnt = <0xc>;
				linux,phandle = <0x19>;
				phandle = <0x19>;

				hs_tune1 {
					tune_name = "tx_vref";
					tune_value = <0xd 0xa>;
				};

				hs_tune2 {
					tune_name = "tx_pre_emp";
					tune_value = <0x3 0x3>;
				};

				hs_tune3 {
					tune_name = "tx_pre_emp_plus";
					tune_value = <0x0 0x0>;
				};

				hs_tune4 {
					tune_name = "tx_res";
					tune_value = <0x3 0x3>;
				};

				hs_tune5 {
					tune_name = "tx_rise";
					tune_value = <0x3 0x3>;
				};

				hs_tune6 {
					tune_name = "tx_hsxv";
					tune_value = <0x3 0x3>;
				};

				hs_tune7 {
					tune_name = "tx_fsls";
					tune_value = <0x3 0x3>;
				};

				hs_tune8 {
					tune_name = "rx_sqrx";
					tune_value = <0x7 0x7>;
				};

				hs_tune9 {
					tune_name = "compdis";
					tune_value = <0x7 0x7>;
				};

				hs_tune10 {
					tune_name = "otg";
					tune_value = <0x2 0x2>;
				};

				hs_tune11 {
					tune_name = "enable_user_imp";
					tune_value = <0x0 0x0>;
				};

				hs_tune12 {
					tune_name = "is_phyclock";
					tune_value = <0x1 0x1>;
				};
			};

			usb_notifier {
				compatible = "samsung,usb-notifier";
				udc = <0xffffffff>;
			};

			dwmmc0@13500000 {
				status = "okay";
				num-slots = <0x1>;
				broken-cd;
				fixed_voltage;
				supports-highspeed;
				mmc-ddr-1_8v;
				mmc-hs200-1_8v;
				mmc-hs400-1_8v;
				supports-8bit;
				supports-cmd23;
				supports-erase;
				mmc-hs400-enhanced-strobe;
				card-init-hwacg-ctrl;
				support-cmdq;
				qos-dvfs-level = <0x186a0>;
				fifo-depth = <0x40>;
				non-removable;
				desc-size = <0x4>;
				card-detect-delay = <0xc8>;
				samsung,dw-mshc-ciu-div = <0x3>;
				samsung,dw-mshc-txdt-crc-timer-fastlimit = <0x13>;
				samsung,dw-mshc-txdt-crc-timer-initval = <0x15>;
				samsung,dw-mshc-hs400-delay-line = <0x60>;
				samsung,dw-mshc-sdr-timing = <0x3 0x0 0x4 0x0>;
				samsung,dw-mshc-ddr-timing = <0x3 0x0 0x4 0x2>;
				samsung,dw-mshc-hs200-timing = <0x3 0x0 0x3 0x0>;
				samsung,dw-mshc-hs400-timing = <0x1 0x0 0x2 0x0>;
				samsung,dw-mshc-hs400-ulp-timing = <0x3 0x0 0x2 0x0>;
				num-ref-clks = <0xc>;
				ciu_clkin = <0x19 0x32 0x32 0x19 0x32 0x64 0xc8 0x32 0x32 0xc8 0xc8 0xc8>;
				clk-drive-number = <0x4>;
				pinctrl-names = "default", "fast-slew-rate-1x", "fast-slew-rate-2x", "fast-slew-rate-3x", "fast-slew-rate-4x";
				pinctrl-0 = <0xffffffff 0xffffffff 0xffffffff 0xffffffff 0xffffffff 0xffffffff 0xffffffff>;
				pinctrl-1 = <0xffffffff>;
				pinctrl-2 = <0xffffffff>;
				pinctrl-3 = <0xffffffff>;
				pinctrl-4 = <0xffffffff>;
				#address-cells = <0x1>;
				#size-cells = <0x0>;

				slot@0 {
					reg = <0x0>;
					bus-width = <0x8>;
				};

				mmc-perf-v1 {
					update = <0x0>;
					policy-num = <0x1>;

					policy1 {
						control = <0x3>;
					};
				};
			};

			dwmmc1@13510000 {
				status = "disabled";
				num-slots = <0x1>;
				channel = <0x1>;
				fixed_voltage;
				enable-cclk-on-suspend;
				caps-control;
				supports-highspeed;
				supports-4bit;
				keep-power-in-suspend;
				pm-ignore-notify;
				card-detect-type-external;
				use-broken-voltage;
				ignore-phase = <0x80>;
				fifo-depth = <0x40>;
				card-detect-delay = <0xc8>;
				qos-dvfs-level = <0x186a0>;
				data-timeout = <0xc8>;
				hto-timeout = <0x50>;
				samsung,dw-mshc-ciu-div = <0x3>;
				samsung,dw-mshc-sdr-timing = <0x3 0x0 0x2 0x0>;
				samsung,dw-mshc-ddr-timing = <0x3 0x0 0x2 0x1>;
				samsung,dw-mshc-sdr50-timing = <0x3 0x0 0x4 0x2>;
				samsung,dw-mshc-sdr104-timing = <0x3 0x0 0x3 0x0>;
				num-ref-clks = <0x9>;
				ciu_clkin = <0x19 0x32 0x32 0x19 0x32 0x64 0xc8 0x32 0x32>;
				clk-drive-number = <0x4>;
				pinctrl-names = "default", "fast-slew-rate-1x", "fast-slew-rate-2x", "fast-slew-rate-3x", "fast-slew-rate-4x";
				pinctrl-0 = <0xffffffff 0xffffffff 0xffffffff 0xffffffff>;
				pinctrl-1 = <0xffffffff>;
				pinctrl-2 = <0xffffffff>;
				pinctrl-3 = <0xffffffff>;
				pinctrl-4 = <0xffffffff>;
				#address-cells = <0x1>;
				#size-cells = <0x0>;

				slot@0 {
					reg = <0x0>;
					bus-width = <0x4>;
				};
			};

			dwmmc2@13550000 {
				status = "okay";
				num-slots = <0x1>;
				supports-4bit;
				supports-cmd23;
				supports-erase;
				supports-highspeed;
				sd-uhs-sdr50;
				sd-uhs-sdr104;
				card-detect-gpio;
				bypass-for-allpass;
				card-init-hwacg-ctrl;
				skip-init-mmc-scan;
				qos-dvfs-level = <0x186a0>;
				qos-sd3-dvfs-level = <0x412f8>;
				fifo-depth = <0x40>;
				desc-size = <0x4>;
				card-detect-delay = <0xc8>;
				data-timeout = <0xc8>;
				hto-timeout = <0x50>;
				samsung,dw-mshc-ciu-div = <0x3>;
				clock-frequency = <0x2faf0800>;
				samsung,dw-mshc-sdr-timing = <0x3 0x0 0x2 0x0>;
				samsung,dw-mshc-ddr-timing = <0x3 0x0 0x2 0x1>;
				samsung,dw-mshc-sdr50-timing = <0x3 0x0 0x4 0x2>;
				samsung,dw-mshc-sdr104-timing = <0x3 0x0 0x3 0x0>;
				num-ref-clks = <0x9>;
				ciu_clkin = <0x19 0x32 0x32 0x19 0x32 0x64 0xc8 0x32 0x32>;
				clk-drive-number = <0x4>;
				pinctrl-names = "default", "fast-slew-rate-1x", "fast-slew-rate-2x", "fast-slew-rate-3x", "fast-slew-rate-4x";
				pinctrl-0 = <0xffffffff 0xffffffff 0xffffffff 0xffffffff 0xf>;
				pinctrl-1 = <0xffffffff>;
				pinctrl-2 = <0xffffffff>;
				pinctrl-3 = <0xffffffff>;
				pinctrl-4 = <0xffffffff>;
				card-detect = <0xffffffff 0x7 0xf>;
				sec-sd-slot-type = <0x2>;
				#address-cells = <0x1>;
				#size-cells = <0x0>;

				slot@0 {
					reg = <0x0>;
					bus-width = <0x4>;
					disable-wp;
				};
			};

			usim_det {
				pinctrl-names = "default";
				pinctrl-0 = <0xffffffff>;
				mif,num_of_usim_det = <0x1>;
				mif,usim-det0-gpio = <0xffffffff 0x6 0x0>;
			};

			mcu_ipc@12080000 {
				compatible = "samsung,exynos-shd-ipc-mailbox";
				reg = <0x0 0x12080000 0x180>;
				mcu,name = "mcu_ipc_cp";
				mcu,id = <0x0>;
				interrupts = <0x0 0x37 0x0>;
				linux,phandle = <0x48>;
				phandle = <0x48>;
			};

			mcu_ipc@120D0000 {
				compatible = "samsung,exynos-shd-ipc-mailbox";
				reg = <0x0 0x120d0000 0xb4>;
				mcu,name = "mcu_ipc_gnss";
				mcu,id = <0x1>;
				interrupts = <0x0 0x38 0x0>;
				linux,phandle = <0x10>;
				phandle = <0x10>;
			};

			gnss_pdata {
				status = "okay";
				compatible = "samsung,gnss_shdmem_if";
				shmem,name = "KEPLER";
				shmem,device_node_name = "gnss_ipc";
				interrupts = <0x0 0x14 0x0 0x0 0xa5 0x0 0x0 0xa4 0x0>;
				interrupt-names = "ACTIVE", "WATCHDOG", "WAKEUP";
				memory-region = <0xffffffff>;
				mbox_info = <0x10>;
				mbx,int_ap2gnss_bcmd = <0x0>;
				mbx,int_ap2gnss_req_fault_info = <0x1>;
				mbx,int_ap2gnss_ipc_msg = <0x2>;
				mbx,int_ap2gnss_ack_wake_set = <0x3>;
				mbx,int_ap2gnss_ack_wake_clr = <0x4>;
				mbx,irq_gnss2ap_bcmd = <0x0>;
				mbx,irq_gnss2ap_rsp_fault_info = <0x1>;
				mbx,irq_gnss2ap_ipc_msg = <0x2>;
				mbx,irq_gnss2ap_req_wake_clr = <0x4>;
				mbx,reg_bcmd_ctrl = <0x0 0x1 0x2 0x3>;
				reg_rx_ipc_msg = <0x1 0x5>;
				reg_tx_ipc_msg = <0x1 0x4>;
				reg_rx_head = <0x1 0x3>;
				reg_rx_tail = <0x1 0x2>;
				reg_tx_head = <0x1 0x1>;
				reg_tx_tail = <0x1 0x0>;
				fault_info = <0x1 0x200000 0x180000>;
				shmem,ipc_offset = <0x380000>;
				shmem,ipc_size = <0x80000>;
				shmem,ipc_reg_cnt = <0x20>;
				shmem,boot_without_mbox = <0x1>;
			};

			audio_codec_dummy {
				status = "okay";
				compatible = "snd-soc-dummy";
				#sound-dai-cells = <0x1>;
				linux,phandle = <0x11>;
				phandle = <0x11>;
			};

			sound {
				status = "okay";
				compatible = "samsung,exynos7885-cod3035";
				mic-bias-mode = <0x1 0x1 0x2 0x0>;
				clock-names = "xclkout";
				samsung,codec = <0xffffffff>;
				samsung,routing = "VOUTPUT", "ABOX UAIF0 Playback", "VOUTPUTCALL", "ABOX UAIF2 Playback", "ABOX UAIF2 Capture", "VINPUTCALL", "ABOX SPEEDY Capture", "VINPUTFM", "SPK", "Playback-8-001e", "Playback-8-001e", "ABOX UAIF3 Playback", "ABOX UAIF3 Capture", "Capture-8-001e";

				rdma@0 {

					cpu {
						sound-dai = <0xffffffff 0x0>;
					};

					codec {
						sound-dai = <0x11>;
					};
				};

				rdma@1 {

					cpu {
						sound-dai = <0xffffffff 0x1>;
					};

					codec {
						sound-dai = <0x11>;
					};
				};

				rdma@2 {

					cpu {
						sound-dai = <0xffffffff 0x2>;
					};

					codec {
						sound-dai = <0x11>;
					};
				};

				rdma@3 {

					cpu {
						sound-dai = <0xffffffff 0x3>;
					};

					codec {
						sound-dai = <0x11>;
					};
				};

				rdma@4 {

					cpu {
						sound-dai = <0xffffffff 0x4>;
					};

					codec {
						sound-dai = <0x11>;
					};
				};

				rdma@5 {

					cpu {
						sound-dai = <0xffffffff 0x5>;
					};

					codec {
						sound-dai = <0x11>;
					};
				};

				rdma@6 {

					cpu {
						sound-dai = <0xffffffff 0x6>;
					};

					codec {
						sound-dai = <0x11>;
					};
				};

				rdma@7 {

					cpu {
						sound-dai = <0xffffffff 0x7>;
					};

					codec {
						sound-dai = <0x11>;
					};
				};

				wdma@0 {

					cpu {
						sound-dai = <0xffffffff 0x8>;
					};

					codec {
						sound-dai = <0x11>;
					};
				};

				wdma@1 {

					cpu {
						sound-dai = <0xffffffff 0x9>;
					};

					codec {
						sound-dai = <0x11>;
					};
				};

				wdma@2 {

					cpu {
						sound-dai = <0xffffffff 0xa>;
					};

					codec {
						sound-dai = <0x11>;
					};
				};

				wdma@3 {

					cpu {
						sound-dai = <0xffffffff 0xb>;
					};

					codec {
						sound-dai = <0x11>;
					};
				};

				wdma@4 {

					cpu {
						sound-dai = <0xffffffff 0xc>;
					};

					codec {
						sound-dai = <0x11>;
					};
				};

				uaif@0 {

					cpu {
						sound-dai = <0xffffffff 0xd>;
					};

					codec {
						sound-dai = <0xc 0x0>;
					};
				};

				uaif@1 {

					cpu {
						sound-dai = <0xffffffff 0xe>;
					};

					codec {
						sound-dai = <0x11>;
					};
				};

				uaif@2 {

					cpu {
						sound-dai = <0xffffffff 0xf>;
					};

					codec {
						sound-dai = <0x11>;
					};
				};

				uaif@3 {

					cpu {
						sound-dai = <0xffffffff 0x10>;
					};

					codec {
						sound-dai = <0x12>;
					};
				};

				internal@0 {

					cpu {
						sound-dai = <0xffffffff 0x11>;
					};

					codec {
						sound-dai = <0x11>;
					};
				};

				speedy@0 {

					cpu {
						sound-dai = <0xffffffff 0x12>;
					};

					codec {
						sound-dai = <0x11>;
					};
				};
			};

			fm@14840000 {
				pinctrl-names;
				pinctrl-0;
				without_elna = <0x1>;
				num-trfon-freq = <0x38>;
				val-trfon-freq = <0x155cc 0x15630 0x158ec 0x15950 0x15ba8 0x15c0c 0x15ec8 0x15f2c 0x161e8 0x1624c 0x164a4 0x16508 0x167c4 0x16828 0x16ae4 0x16b48 0x16da0 0x16e04 0x170c0 0x17124 0x173e0 0x17444 0x179bc 0x17a20 0x17cdc 0x17d40 0x17ffc 0x18060 0x182b8 0x185d8 0x1863c 0x1831c 0x186a0 0x188f8 0x1895c 0x18bb4 0x18c18 0x18c7c 0x18ce0 0x18ed4 0x18f38 0x191f4 0x19258 0x194b0 0x19514 0x19640 0x197d0 0x19834 0x19af0 0x19b54 0x19dac 0x19e10 0x1a0cc 0x1a130 0x1a3ec 0x1a450>;
				spur-trfon-freq = <0x600>;
				num-volume-level = <0x10>;
				val-vol-level = <0x0 0xe 0x14 0x1d 0x29 0x3a 0x51 0x73 0xa3 0xe6 0x144 0x1ca 0x287 0x392 0x50c 0x720>;
			};

			flip_cover {
				status = "okay";
				compatible = "flip_cover";
				pinctrl-names = "default";
				pinctrl-0 = <0x13>;

				hall {
					event = <0x15>;
					gpios = <0xffffffff 0x2 0x0>;
				};
			};

			i2c@20 {
				compatible = "i2c-gpio";
				gpios = <0xffffffff 0x0 0x0 0xffffffff 0x1 0x0>;
				i2c-gpio,delay-us = <0x2>;
				pinctrl-names = "default";
				pinctrl-0 = <0x14 0x15>;
				#address-cells = <0x1>;
				#size-cells = <0x0>;
				status = "okay";

				sx9360-i2c@28 {
					compatible = "sx9360";
					pinctrl-names = "default";
					pinctrl-0 = <0x16>;
					reg = <0x28>;
					interrupt-parent = <0xffffffff>;
					interrupts = <0x6 0x0 0x0>;
					sx9360,nirq-gpio = <0xffffffff 0x6 0x0>;
					sx9360,reggnrlctrl2 = <0x28>;
					sx9360,regafeparam1phm = <0x63>;
					sx9360,regproxctrl0phm = <0x21>;
					sx9360,regproxctrl5 = <0x5f>;
					sx9360,regproxctrl4 = <0x15>;
					sx9360,regproxctrl3 = <0xd>;
					sx9360,regafeparam0phm = <0xe>;
					sx9360,hallic_detect = <0x1>;
				};
			};

			secgpio_dvs {
				compatible = "samsung,exynos7885-secgpio-dvs";
				status = "okay";
			};

			cpufreq-ufc {
				device_type = "cpufreq_ufc";
				table-col = <0x4>;
				table-row = <0x4>;
				fill-flag = <0x1>;

				domain@0 {
					device_type = "ufc_domain";
					shared-cpus = "0-5";
					table-idx = <0x2>;
					pm_qos-min-class = <0x3>;
					pm_qos-max-class = <0x4>;
				};

				domain@1 {
					device_type = "ufc_domain";
					shared-cpus = "6-7";
					table-idx = <0x1>;
					pm_qos-min-class = <0x5>;
					pm_qos-max-class = <0x6>;

					min-limit {
						device_type = "ufc_table";
						ctrl-type = <0x0>;
						execution-mode = <0x0>;
						table = <0x17cdc0 0x17cdc0 0x14a140 0x2 0x14a140 0x14a140 0xccd58 0x1 0x1174c0 0x1174c0 0xccd58 0x1 0xe4840 0xe4840 0xccd58 0x1>;
					};

					max-limit {
						device_type = "ufc_table";
						ctrl-type = <0x2>;
						execution-mode = <0x0>;
						table = <0x17cdc0 0x17cdc0 0x14a140 0x0 0x14a140 0x14a140 0x14a140 0x0 0x1174c0 0x1174c0 0x14a140 0x0 0xe4840 0xe4840 0x130b00 0x0>;
					};
				};
			};

			sec_thermistor@0 {
				compatible = "samsung,sec-thermistor";
				status = "okay";
				thermistor_name = "sec-ap-thermistor";
				id = <0x0>;
				adc_array = <0x113 0x144 0x17c 0x1c2 0x210 0x26b 0x2d9 0x358 0x3eb 0x489 0x541 0x609 0x6e6 0x7bc 0x8ae 0x999 0xa7d 0xb55 0xc1e 0xccf 0xd62 0xddf 0xe4b>;
				temp_array = <0x384 0x352 0x320 0x2ee 0x2bc 0x28a 0x258 0x226 0x1f4 0x1c2 0x190 0x15e 0x12c 0xfa 0xc8 0x96 0x64 0x32 0x0 0xffffffce 0xffffff9c 0xffffff6a 0xffffff38>;
				io-channels = <0xffffffff 0x0>;
				io-channel-names = "adc-ap-temp";
				io-channel-ranges;
			};

			sec_thermistor@6 {
				compatible = "samsung,sec-thermistor";
				status = "okay";
				thermistor_name = "sec-cf-thermistor";
				id = <0x1>;
				adc_array = <0x113 0x144 0x17c 0x1c2 0x210 0x26b 0x2d9 0x358 0x3eb 0x489 0x541 0x609 0x6e6 0x7bc 0x8ae 0x999 0xa7d 0xb55 0xc1e 0xccf 0xd62 0xddf 0xe4b>;
				temp_array = <0x384 0x352 0x320 0x2ee 0x2bc 0x28a 0x258 0x226 0x1f4 0x1c2 0x190 0x15e 0x12c 0xfa 0xc8 0x96 0x64 0x32 0x0 0xffffffce 0xffffff9c 0xffffff6a 0xffffff38>;
				io-channels = <0xffffffff 0x6>;
				io-channel-names = "adc-cf-temp";
				io-channel-ranges;
			};
		};
	};

	fragment@18 {
		target = <0xffffffff>;

		__overlay__ {
			bootargs_ext = "root=/dev/ram0 androidboot.boot_devices=13500000.dwmmc0";
		};
	};

	fragment@19 {
		target = <0xffffffff>;

		__overlay__ {
			status = "okay";
		};
	};

	fragment@20 {
		target = <0xffffffff>;

		__overlay__ {
			max-freq = <0x14a140>;

			dm-constraints {

				mif-perf {
					table = <0x14a140 0xf78f0 0x130b00 0xf78f0 0x1174c0 0xce4c8 0xf78f0 0xce4c8 0xdc370 0xa50a0 0xccd58 0xa50a0 0xb8d08 0x854d0 0xa50a0 0x854d0 0x854d0 0x668a0 0x6d9e8 0x668a0 0x53bd8 0x668a0 0x32c80 0x668a0>;
				};
			};
		};
	};

	fragment@21 {
		target = <0xffffffff>;

		__overlay__ {
			max-freq = <0x17cdc0>;

			dm-constraints {

				mif-perf {
					table = <0x17cdc0 0x1b5fd0 0x14a140 0x14a140 0x1174c0 0xf78f0 0xe4840 0x854d0 0xb1bc0 0x668a0>;
				};
			};
		};
	};

	fragment@22 {
		target = <0xffffffff>;

		__overlay__ {

			key-power {
				samsung,pins = "gpa1-7";
				samsung,pin-function = <0xf>;
				samsung,pin-pud = <0x0>;
				samsung,pin-drv = <0x0>;
				linux,phandle = <0x9>;
				phandle = <0x9>;
			};

			key-voldown {
				samsung,pins = "gpa1-6";
				samsung,pin-function = <0xf>;
				samsung,pin-pud = <0x0>;
				samsung,pin-drv = <0x0>;
				linux,phandle = <0x7>;
				phandle = <0x7>;
			};

			key-volup {
				samsung,pins = "gpa1-5";
				samsung,pin-function = <0xf>;
				samsung,pin-pud = <0x0>;
				samsung,pin-drv = <0x0>;
				linux,phandle = <0x8>;
				phandle = <0x8>;
			};

			dwmmc2_cd_ext_irq {
				samsung,pins = "gpa0-7";
				samsung,pin-function = <0xf>;
				samsung,pin-pud = <0x0>;
				samsung,pin-drv = <0x3>;
				linux,phandle = <0xf>;
				phandle = <0xf>;
			};

			attn-irq {
				samsung,pins = "gpa0-0";
				samsung,pin-function = <0xf>;
				samsung,pin-pud = <0x0>;
				samsung,pin-drv = <0x0>;
				linux,phandle = <0x18>;
				phandle = <0x18>;
			};

			attn-input {
				samsung,pins = "gpa0-0";
				samsung,pin-function = <0x0>;
				samsung,pin-pud = <0x1>;
				linux,phandle = <0x49>;
				phandle = <0x49>;
			};

			hall-irq {
				samsung,pins = "gpa0-2";
				samsung,pin-function = <0xf>;
				samsung,pin-pud = <0x0>;
				samsung,pin-drv = <0x0>;
				linux,phandle = <0x13>;
				phandle = <0x13>;
			};

			grip-input {
				samsung,pins = "gpa0-6";
				samsung,pin-function = <0x0>;
				samsung,pin-pud = <0x0>;
				samsung,pin-drv = <0x0>;
				linux,phandle = <0x4a>;
				phandle = <0x4a>;
			};
		};
	};

	fragment@23 {
		target = <0xffffffff>;

		__overlay__ {

			vdd-on {
				samsung,pins = "gpg3-0";
				samsung,pin-function = <0x1>;
				samsung,pin-val = <0x1>;
				samsung,pin-pud = <0x0>;
				linux,phandle = <0x4b>;
				phandle = <0x4b>;
			};

			vdd-off {
				samsung,pins = "gpg3-0";
				samsung,pin-function = <0x0>;
				samsung,pin-val = <0x0>;
				samsung,pin-pud = <0x1>;
				linux,phandle = <0x4c>;
				phandle = <0x4c>;
			};

			grip-i2c {
				samsung,pins = "gpp7-1", "gpp7-0";
				samsung,pin-function = <0x2>;
				samsung,pin-pud = <0x0>;
				samsung,pin-drv = <0x0>;
				samsung,pin-con-pdn = <0x2>;
				samsung,pin-pud-pdn = <0x0>;
				linux,phandle = <0x14>;
				phandle = <0x14>;
			};

			grip-en {
				samsung,pins = "gpg1-6";
				samsung,pin-function = <0x1>;
				samsung,pin-pud = <0x0>;
				samsung,pin-val = <0x1>;
				samsung,pin-drv = <0x0>;
				samsung,pin-con-pdn = <0x3>;
				samsung,pin-pud-pdn = <0x0>;
				linux,phandle = <0x15>;
				phandle = <0x15>;
			};

			amp-i2c {
				samsung,pins = "gpp3-1", "gpp3-0";
				samsung,pin-function = <0x2>;
				samsung,pin-pud = <0x3>;
				samsung,pin-pud-pdn = <0x0>;
				samsung,pin-drv = <0x0>;
				linux,phandle = <0x17>;
				phandle = <0x17>;
			};
		};
	};

	fragment@24 {
		target = <0xffffffff>;

		__overlay__ {
			status = "okay";
			pinctrl-0 = <0xffffffff 0xffffffff 0xffffffff 0xffffffff 0xffffffff>;
			pinctrl-1 = <0xffffffff 0xffffffff 0xffffffff 0xffffffff 0xffffffff>;
			samsung,abox-bootargs = "init=ab0x vss=1";
			samsung,abox-bootargs-offset = <0x22e00>;

			ext_bin@0 {
				status = "disabled";
				linux,phandle = <0x4d>;
				phandle = <0x4d>;
			};

			ext_bin@1 {
				status = "okay";
				samsung,name = "AP_AUDIO_SLSI.bin";
				samsung,area = <0x1>;
				samsung,offset = <0x7f0000>;
				linux,phandle = <0x4e>;
				phandle = <0x4e>;
			};

			ext_bin@2 {
				status = "okay";
				samsung,name = "APBargeIn_AUDIO_SLSI.bin";
				samsung,area = <0x1>;
				samsung,offset = <0x7ec000>;
				linux,phandle = <0x4f>;
				phandle = <0x4f>;
			};
		};
	};

	fragment@25 {
		target = <0xffffffff>;

		__overlay__ {
			status = "okay";
			#address-cells = <0x1>;
			#size-cells = <0x0>;
			samsung,i2c-max-bus-freq = <0x61a80>;
			pinctrl-names = "default";
			pinctrl-0 = <0x17>;

			sma1303@1e {
				compatible = "siliconmitus,sma1303";
				#sound-dai-cells = <0x0>;
				reg = <0x1e>;
				init-vol = <0x31>;
				sys-clk-id = <0x3>;
				status = "okay";
				linux,phandle = <0x12>;
				phandle = <0x12>;
			};
		};
	};

	fragment@26 {
		target = <0xffffffff>;

		__overlay__ {
			samsung,pins = "gpp4-1", "gpp4-0";
			samsung,pin-function = <0x2>;
			samsung,pin-pud = <0x0>;
			samsung,pin-drv = <0x0>;
			samsung,pin-pud-pdn = <0x0>;
		};
	};

	fragment@27 {
		target = <0xffffffff>;

		__overlay__ {
			status = "okay";
			samsung,i2c-sda-delay = <0x64>;
			samsung,i2c-max-bus-freq = <0x61a80>;

			himax_ts@48 {
				compatible = "himax,hxcommon";
				reg = <0x48>;
				pinctrl-names = "default";
				pinctrl-0 = <0x18>;
				himax,irq-gpio = <0xffffffff 0x0 0x0>;
				himax,panel-coords = <0x0 0x2d0 0x0 0x618>;
				himax,display-coords = <0x0 0x2d0 0x0 0x618>;
				himax,project_name = "A10e", "A102U";
				himax,area-size = <0x50 0x58 0x3c>;
				himax,select_lcdid = <0x116234 0x9a6234>;
				himax,fw-path = "tsp_himax/hx83102d_a20e.bin", "tsp_himax/hx83102d_a10eu.bin";
				report_type = <0x1>;
				himax,factory_item_version = <0x2>;
			};
		};
	};

	fragment@28 {
		target = <0xffffffff>;

		__overlay__ {
			status = "okay";

			dwc3 {
				dr_mode = "otg";
				maximum-speed = "high-speed";
				snps,quirk-frame-length-adjustment = <0x20>;
			};
		};
	};

	fragment@29 {
		target = <0xffffffff>;

		__overlay__ {
			status = "okay";
			hs_tune_param = <0x19>;
		};
	};

	fragment@30 {
		target = <0xffffffff>;

		__overlay__ {

			pmic-irq {
				samsung,pins = "gpa2-0";
				samsung,pin-pud = <0x3>;
				samsung,pin-drv = <0x3>;
				linux,phandle = <0xd>;
				phandle = <0xd>;
			};
		};
	};

	fragment@31 {
		target = <0xffffffff>;

		__overlay__ {

			pm-wrsti {
				samsung,pins = "gpg1-1";
				samsung,pin-con-pdn = <0x3>;
				samsung,pin-pud-pdn = <0x0>;
				linux,phandle = <0xe>;
				phandle = <0xe>;
			};
		};
	};

	fragment@32 {
		target = <0xffffffff>;

		__overlay__ {

			nfc-clk {
				samsung,pins = "gpq0-0";
				samsung,pin-function = <0x2>;
				samsung,pin-pud = <0x0>;
				linux,phandle = <0x50>;
				phandle = <0x50>;
			};

			nfc-int {
				samsung,pins = "gpa1-0";
				samsung,pin-function = <0x0>;
				samsung,pin-pud = <0x1>;
				linux,phandle = <0x1c>;
				phandle = <0x1c>;
			};
		};
	};

	fragment@33 {
		target = <0xffffffff>;

		__overlay__ {

			nfc_pvdd_en {
				samsung,pins = "gpp6-4";
				samsung,pin-function = <0x1>;
				samsung,pin-pud = <0x0>;
				samsung,pin-val = <0x0>;
				samsung,pin-con-pdn = <0x3>;
				samsung,pin-pud-pdn = <0x0>;
				linux,phandle = <0x1d>;
				phandle = <0x1d>;
			};

			nfc_firm {
				samsung,pins = "gpp3-2";
				samsung,pin-function = <0x1>;
				samsung,pin-pud = <0x0>;
				samsung,pin-val = <0x0>;
				samsung,pin-con-pdn = <0x3>;
				samsung,pin-pud-pdn = <0x0>;
				linux,phandle = <0x1b>;
				phandle = <0x1b>;
			};

			nfc_pd {
				samsung,pins = "gpp2-2";
				samsung,pin-function = <0x2>;
				samsung,pin-pud = <0x0>;
				samsung,pin-drv = <0x0>;
				samsung,pin-con-pdn = <0x3>;
				samsung,pin-pud-pdn = <0x0>;
				linux,phandle = <0x1a>;
				phandle = <0x1a>;
			};
		};
	};

	fragment@34 {
		target = <0xffffffff>;

		__overlay__ {
			usi_mode = "hsi2c1";
			status = "okay";
		};
	};

	fragment@35 {
		target = <0xffffffff>;

		__overlay__ {
			status = "okay";
			clock-frequency = <0x61a80>;

			sec-nfc@27 {
				compatible = "sec-nfc";
				reg = <0x27>;
				interrupt-parent = <0xffffffff>;
				interrupts = <0x0 0x0 0x0>;
				sec-nfc,nfc_pd = <0xffffffff 0x2 0x2>;
				sec-nfc,firm-gpio = <0xffffffff 0x2 0x1>;
				sec-nfc,irq-gpio = <0xffffffff 0x0 0x0>;
				sec-nfc,pvdd_en = <0xffffffff 0x4 0x1>;
				clkctrl-reg = <0x11c8600c>;
				pinctrl-names = "default";
				pinctrl-0 = <0x1a 0x1b 0x1c 0x1d>;
			};
		};
	};

	fragment@36 {
		target = <0xffffffff>;

		__overlay__ {

			acc-int {
				samsung,pins = "gpa0-3";
				samsung,pin-function = <0xf>;
				samsung,pin-pud = <0x0>;
				samsung,pin-drv = <0x0>;
				linux,phandle = <0x23>;
				phandle = <0x23>;
			};

			proxy-int {
				samsung,pins = "gpa0-4";
				samsung,pin-function = <0xf>;
				samsung,pin-pud = <0x0>;
				samsung,pin-drv = <0x0>;
				linux,phandle = <0x1f>;
				phandle = <0x1f>;
			};

			gyro-int {
				samsung,pins = "gpa0-1";
				samsung,pin-function = <0x0>;
				samsung,pin-pud = <0x1>;
				samsung,pin-drv = <0x0>;
				linux,phandle = <0x24>;
				phandle = <0x24>;
			};

			grip-int {
				samsung,pins = "gpa0-6";
				samsung,pin-function = <0xf>;
				samsung,pin-pud = <0x0>;
				samsung,pin-drv = <0x0>;
				linux,phandle = <0x16>;
				phandle = <0x16>;
			};
		};
	};

	fragment@37 {
		target = <0xffffffff>;

		__overlay__ {

			i2c5-bus {
				samsung,pins = "gpp4-3", "gpp4-2";
				samsung,pin-function = <0x2>;
				samsung,pin-pud = <0x0>;
				samsung,pin-drv = <0x0>;
				samsung,pin-con-pdn = <0x2>;
				samsung,pin-pud-pdn = <0x0>;
				linux,phandle = <0x1e>;
				phandle = <0x1e>;
			};

			i2c6-bus {
				samsung,pins = "gpp4-5", "gpp4-4";
				samsung,pin-function = <0x2>;
				samsung,pin-pud = <0x0>;
				samsung,pin-drv = <0x0>;
				samsung,pin-con-pdn = <0x2>;
				samsung,pin-pud-pdn = <0x0>;
				linux,phandle = <0x21>;
				phandle = <0x21>;
			};

			sensor-en {
				samsung,pins = "gpg3-1";
				samsung,pin-function = <0x1>;
				samsung,pin-pud = <0x0>;
				samsung,pin-drv = <0x0>;
				samsung,pin-val = <0x1>;
				samsung,pin-con-pdn = <0x3>;
				samsung,pin-pud-pdn = <0x0>;
				linux,phandle = <0x22>;
				phandle = <0x22>;
			};

			prox-ldo {
				samsung,pins = "gpp8-1";
				samsung,pin-function = <0x1>;
				samsung,pin-pud = <0x0>;
				samsung,pin-drv = <0x0>;
				samsung,pin-val = <0x1>;
				samsung,pin-con-pdn = <0x3>;
				samsung,pin-pud-pdn = <0x0>;
				linux,phandle = <0x20>;
				phandle = <0x20>;
			};
		};
	};

	fragment@38 {
		target = <0xffffffff>;

		__overlay__ {
			status = "okay";
			#address-cells = <0x1>;
			#size-cells = <0x0>;
			samsung,i2c-sda-delay = <0x64>;
			samsung,i2c-max-bus-freq = <0x61a80>;
			pinctrl-names = "default";
			pinctrl-0 = <0x1e>;

			gp2a@39 {
				compatible = "sharp,gp2ap110s";
				reg = <0x39>;
				pinctrl-names = "default";
				pinctrl-0 = <0x1f 0x20>;
				interrupt-parent = <0xffffffff>;
				interrupts = <0x4 0x0 0x0>;
				gp2ap110s,led_reg_val_1 = <0x14>;
				gp2ap110s,ps_high_th_1 = <0x172>;
				gp2ap110s,ps_low_th_1 = <0x104>;
				gp2ap110s,led_reg_val_2 = <0x24>;
				gp2ap110s,ps_high_th_2 = <0xc8>;
				gp2ap110s,ps_low_th_2 = <0xaa>;
				gp2ap110s,settings_thd_low = <0x82>;
				gp2ap110s,settings_thd_high = <0x226>;
				gp2ap110s,force_close_thd_low = <0x15e>;
				gp2ap110s,force_close_thd_high = <0x212>;
				gp2ap110s,gpio_int = <0xffffffff 0x4 0x0>;
			};
		};
	};

	fragment@39 {
		target = <0xffffffff>;

		__overlay__ {
			status = "okay";
			#address-cells = <0x1>;
			#size-cells = <0x0>;
			samsung,i2c-sda-delay = <0x64>;
			samsung,i2c-max-bus-freq = <0x61a80>;
			pinctrl-names = "default";
			pinctrl-0 = <0x21 0x22>;

			lsm6dsl@6b {
				compatible = "st,lsm6dsl";
				reg = <0x6b>;
				gpio-controller;
				#gpio-cells = <0x2>;
				pinctrl-names = "default";
				pinctrl-0 = <0x23 0x24>;
				interrupt-parent = <0xffffffff>;
				interrupts = <0x3 0x0 0x0>;
				st,irq_gpio = <0xffffffff 0x3 0x0>;
				st,orientation = <0x1 0x0 0x1 0x2 0x1 0x1 0x1 0x1 0x2>;
			};
		};
	};

	fragment@40 {
		target = <0xffffffff>;

		__overlay__ {
			pinctrl-names = "default";
			pinctrl-0 = <0x25>;

			initial-state {
				linux,phandle = <0x25>;
				phandle = <0x25>;

				gpa2-7 {
					samsung,pins = "gpa2-7";
					samsung,pin-function = <0x0>;
					samsung,pin-pud = <0x1>;
				};

				gpq0-0 {
					samsung,pins = "gpq0-0";
					samsung,pin-function = <0x0>;
					samsung,pin-pud = <0x1>;
				};

				gpq0-1 {
					samsung,pins = "gpq0-1";
					samsung,pin-function = <0x0>;
					samsung,pin-pud = <0x1>;
				};
			};
		};
	};

	fragment@41 {
		target = <0xffffffff>;

		__overlay__ {
			pinctrl-names = "default", "sleep";
			pinctrl-0 = <0x26>;
			pinctrl-1 = <0x27>;

			initial-state {
				linux,phandle = <0x26>;
				phandle = <0x26>;

				gpc0-0 {
					samsung,pins = "gpc0-0";
					samsung,pin-function = <0x0>;
					samsung,pin-pud = <0x1>;
				};

				gpg1-3 {
					samsung,pins = "gpg1-3";
					samsung,pin-function = <0x0>;
					samsung,pin-pud = <0x0>;
					samsung,pin-con-pdn = <0x2>;
					samsung,pin-pud-pdn = <0x0>;
				};

				gpg3-6 {
					samsung,pins = "gpg3-6";
					samsung,pin-function = <0x0>;
					samsung,pin-pud = <0x0>;
					samsung,pin-con-pdn = <0x2>;
					samsung,pin-pud-pdn = <0x0>;
				};

				gpg3-7 {
					samsung,pins = "gpg3-7";
					samsung,pin-function = <0x0>;
					samsung,pin-pud = <0x0>;
					samsung,pin-con-pdn = <0x2>;
					samsung,pin-pud-pdn = <0x0>;
				};

				gpg4-0 {
					samsung,pins = "gpg4-0";
					samsung,pin-function = <0x0>;
					samsung,pin-pud = <0x0>;
					samsung,pin-con-pdn = <0x2>;
					samsung,pin-pud-pdn = <0x0>;
				};
			};

			sleep-state {
				linux,phandle = <0x27>;
				phandle = <0x27>;

				gpc0-0 {
					samsung,pins = "gpc0-0";
					samsung,pin-con-pdn = <0x2>;
					samsung,pin-pud-pdn = <0x1>;
				};

				gpc1-0 {
					samsung,pins = "gpc1-0";
					samsung,pin-con-pdn = <0x2>;
					samsung,pin-pud-pdn = <0x1>;
				};

				gpc1-1 {
					samsung,pins = "gpc1-1";
					samsung,pin-con-pdn = <0x2>;
					samsung,pin-pud-pdn = <0x1>;
				};

				gpc1-2 {
					samsung,pins = "gpc1-2";
					samsung,pin-con-pdn = <0x2>;
					samsung,pin-pud-pdn = <0x1>;
				};

				gpc1-3 {
					samsung,pins = "gpc1-3";
					samsung,pin-con-pdn = <0x2>;
					samsung,pin-pud-pdn = <0x1>;
				};

				gpc1-4 {
					samsung,pins = "gpc1-4";
					samsung,pin-con-pdn = <0x2>;
					samsung,pin-pud-pdn = <0x1>;
				};

				gpc1-5 {
					samsung,pins = "gpc1-5";
					samsung,pin-con-pdn = <0x2>;
					samsung,pin-pud-pdn = <0x1>;
				};

				gpc1-6 {
					samsung,pins = "gpc1-6";
					samsung,pin-con-pdn = <0x2>;
					samsung,pin-pud-pdn = <0x1>;
				};

				gpc1-7 {
					samsung,pins = "gpc1-7";
					samsung,pin-con-pdn = <0x2>;
					samsung,pin-pud-pdn = <0x1>;
				};

				gpp0-3 {
					samsung,pins = "gpp0-3";
					samsung,pin-con-pdn = <0x0>;
					samsung,pin-pud-pdn = <0x1>;
				};

				gpp1-2 {
					samsung,pins = "gpp1-2";
					samsung,pin-con-pdn = <0x3>;
					samsung,pin-pud-pdn = <0x0>;
				};

				gpp1-3 {
					samsung,pins = "gpp1-3";
					samsung,pin-con-pdn = <0x3>;
					samsung,pin-pud-pdn = <0x0>;
				};

				gpp2-0 {
					samsung,pins = "gpp2-0";
					samsung,pin-con-pdn = <0x2>;
					samsung,pin-pud-pdn = <0x0>;
				};

				gpp2-1 {
					samsung,pins = "gpp2-1";
					samsung,pin-con-pdn = <0x2>;
					samsung,pin-pud-pdn = <0x0>;
				};

				gpg1-0 {
					samsung,pins = "gpg1-0";
					samsung,pin-con-pdn = <0x3>;
					samsung,pin-pud-pdn = <0x0>;
				};

				gpg1-2 {
					samsung,pins = "gpg1-2";
					samsung,pin-con-pdn = <0x3>;
					samsung,pin-pud-pdn = <0x0>;
				};

				gpg2-0 {
					samsung,pins = "gpg2-0";
					samsung,pin-con-pdn = <0x3>;
					samsung,pin-pud-pdn = <0x0>;
				};
			};
		};
	};

	__symbols__ {
		decon_board_hx83102d = "/fragment@lcd/__overlay__/decon_board_hx83102d";
		hx83102d = "/fragment@lcd/__overlay__/hx83102d";
		if_pmic_irq = "/fragment@ifpmic/__overlay__/pinctrl@11CB0000/if-pmic-irq";
		usbpd_irq = "/fragment@ifpmic/__overlay__/pinctrl@11CB0000/usbpd-irq";
		shmem = "/fragment@modemif/__overlay__/shmem@F6E00000";
		fuel_irq = "/fragment@5/__overlay__/fuel-irq";
		fimc_is_sensor_3l6 = "/fragment@camera/__overlay__/fimc-is_sensor_3l6@5A";
		fimc_is_sensor_5e9 = "/fragment@camera/__overlay__/fimc-is_sensor_5e9@23";
		fimc_is_flash_gpio = "/fragment@camera/__overlay__/fimc-is-flash_gpio@0";
		flash_off_state = "/fragment@16/__overlay__/flash_off_state";
		android = "/fragment@model/__overlay__/firmware/android";
		but_zones = "/fragment@model/__overlay__/but_zones";
		speedy = "/fragment@model/__overlay__/speedy@11CE0000";
		audio_codec_cod3035x = "/fragment@model/__overlay__/speedy@11CE0000/cod3035x@03";
		b1_reg = "/fragment@model/__overlay__/speedy@11CE0000/s2mpu08mfd@00/regulators/BUCK1";
		b2_reg = "/fragment@model/__overlay__/speedy@11CE0000/s2mpu08mfd@00/regulators/BUCK2";
		b3_reg = "/fragment@model/__overlay__/speedy@11CE0000/s2mpu08mfd@00/regulators/BUCK3";
		b4_reg = "/fragment@model/__overlay__/speedy@11CE0000/s2mpu08mfd@00/regulators/BUCK4";
		b5_reg = "/fragment@model/__overlay__/speedy@11CE0000/s2mpu08mfd@00/regulators/BUCK5";
		b6_reg = "/fragment@model/__overlay__/speedy@11CE0000/s2mpu08mfd@00/regulators/BUCK6";
		b7_reg = "/fragment@model/__overlay__/speedy@11CE0000/s2mpu08mfd@00/regulators/BUCK7";
		b8_reg = "/fragment@model/__overlay__/speedy@11CE0000/s2mpu08mfd@00/regulators/BUCK8";
		l1_reg = "/fragment@model/__overlay__/speedy@11CE0000/s2mpu08mfd@00/regulators/LDO1";
		l2_reg = "/fragment@model/__overlay__/speedy@11CE0000/s2mpu08mfd@00/regulators/LDO2";
		l3_reg = "/fragment@model/__overlay__/speedy@11CE0000/s2mpu08mfd@00/regulators/LDO3";
		l4_reg = "/fragment@model/__overlay__/speedy@11CE0000/s2mpu08mfd@00/regulators/LDO4";
		l5_reg = "/fragment@model/__overlay__/speedy@11CE0000/s2mpu08mfd@00/regulators/LDO5";
		l6_reg = "/fragment@model/__overlay__/speedy@11CE0000/s2mpu08mfd@00/regulators/LDO6";
		l7_reg = "/fragment@model/__overlay__/speedy@11CE0000/s2mpu08mfd@00/regulators/LDO7";
		l8_reg = "/fragment@model/__overlay__/speedy@11CE0000/s2mpu08mfd@00/regulators/LDO8";
		l9_reg = "/fragment@model/__overlay__/speedy@11CE0000/s2mpu08mfd@00/regulators/LDO9";
		l10_reg = "/fragment@model/__overlay__/speedy@11CE0000/s2mpu08mfd@00/regulators/LDO10";
		l11_reg = "/fragment@model/__overlay__/speedy@11CE0000/s2mpu08mfd@00/regulators/LDO11";
		l12_reg = "/fragment@model/__overlay__/speedy@11CE0000/s2mpu08mfd@00/regulators/LDO12";
		l13_reg = "/fragment@model/__overlay__/speedy@11CE0000/s2mpu08mfd@00/regulators/LDO13";
		l14_reg = "/fragment@model/__overlay__/speedy@11CE0000/s2mpu08mfd@00/regulators/LDO14";
		l33_reg = "/fragment@model/__overlay__/speedy@11CE0000/s2mpu08mfd@00/regulators/LDO33";
		l34_reg = "/fragment@model/__overlay__/speedy@11CE0000/s2mpu08mfd@00/regulators/LDO34";
		l35_reg = "/fragment@model/__overlay__/speedy@11CE0000/s2mpu08mfd@00/regulators/LDO35";
		l36_reg = "/fragment@model/__overlay__/speedy@11CE0000/s2mpu08mfd@00/regulators/LDO36";
		l37_reg = "/fragment@model/__overlay__/speedy@11CE0000/s2mpu08mfd@00/regulators/LDO37";
		usb_hs_tune = "/fragment@model/__overlay__/hs_tune";
		mailbox_cp = "/fragment@model/__overlay__/mcu_ipc@12080000";
		mailbox_gnss = "/fragment@model/__overlay__/mcu_ipc@120D0000";
		dummy_audio_codec = "/fragment@model/__overlay__/audio_codec_dummy";
		key_power = "/fragment@22/__overlay__/key-power";
		key_voldown = "/fragment@22/__overlay__/key-voldown";
		key_volup = "/fragment@22/__overlay__/key-volup";
		dwmmc2_cd_ext_irq = "/fragment@22/__overlay__/dwmmc2_cd_ext_irq";
		attn_irq = "/fragment@22/__overlay__/attn-irq";
		attn_input = "/fragment@22/__overlay__/attn-input";
		hall_irq = "/fragment@22/__overlay__/hall-irq";
		grip_input = "/fragment@22/__overlay__/grip-input";
		vdd_on = "/fragment@23/__overlay__/vdd-on";
		vdd_off = "/fragment@23/__overlay__/vdd-off";
		grip_i2c = "/fragment@23/__overlay__/grip-i2c";
		grip_en = "/fragment@23/__overlay__/grip-en";
		amp_i2c = "/fragment@23/__overlay__/amp-i2c";
		ext_bin_0 = "/fragment@24/__overlay__/ext_bin@0";
		ext_bin_1 = "/fragment@24/__overlay__/ext_bin@1";
		ext_bin_2 = "/fragment@24/__overlay__/ext_bin@2";
		sma1303_amp = "/fragment@25/__overlay__/sma1303@1e";
		pmic_irq = "/fragment@30/__overlay__/pmic-irq";
		pm_wrsti = "/fragment@31/__overlay__/pm-wrsti";
		nfc_clk = "/fragment@32/__overlay__/nfc-clk";
		nfc_int = "/fragment@32/__overlay__/nfc-int";
		nfc_pvdd_en = "/fragment@33/__overlay__/nfc_pvdd_en";
		nfc_firm = "/fragment@33/__overlay__/nfc_firm";
		nfc_pd = "/fragment@33/__overlay__/nfc_pd";
		acc_int = "/fragment@36/__overlay__/acc-int";
		proxy_int = "/fragment@36/__overlay__/proxy-int";
		gyro_int = "/fragment@36/__overlay__/gyro-int";
		grip_int = "/fragment@36/__overlay__/grip-int";
		i2c5_bus = "/fragment@37/__overlay__/i2c5-bus";
		i2c6_bus = "/fragment@37/__overlay__/i2c6-bus";
		sensor_en = "/fragment@37/__overlay__/sensor-en";
		prox_ldo = "/fragment@37/__overlay__/prox-ldo";
		initial0 = "/fragment@40/__overlay__/initial-state";
		initial3 = "/fragment@41/__overlay__/initial-state";
		sleep3 = "/fragment@41/__overlay__/sleep-state";
	};

	__fixups__ {
		gpg1 = "/fragment@lcd/__overlay__/decon_board_hx83102d:gpio_lcd_3p0:0", "/fragment@lcd/__overlay__/decon_board_hx83102d:gpio_blic_on:0", "/fragment@camera/__overlay__/fimc-is_sensor_3l6@5A:gpio_cam_ldo_en:0", "/fragment@camera/__overlay__/fimc-is_sensor_3l6@5A:gpio_camio_1p8_en:0", "/fragment@camera/__overlay__/fimc-is_sensor_5e9@23:gpio_camio_1p8_en:0";
		gpg2 = "/fragment@lcd/__overlay__/decon_board_hx83102d:gpio_lcd_rst:0", "/fragment@camera/__overlay__/fimc-is_sensor_5e9@23:gpio_cam_core_en:0", "/fragment@camera/__overlay__/fimc-is-flash_gpio@0:flash-gpio:0", "/fragment@17/__overlay__/s2mu106@3D/flash_led:flash-gpio:0";
		dsim_0 = "/fragment@0:target:0";
		decon_f = "/fragment@1:target:0";
		i2c2_bus = "/fragment@2:target:0";
		i2c_2 = "/fragment@3:target:0";
		gpa2 = "/fragment@ifpmic/__overlay__/i2c@13840000/s2mu106@3D:s2mu106,irq-gpio:0", "/fragment@ifpmic/__overlay__/i2c@13830000/usbpd-s2mu106@3C:usbpd,usbpd_int:0", "/fragment@6/__overlay__/s2mu106-fuelgauge@3B:fuelgauge,fuel_int:0", "/fragment@model/__overlay__/speedy@11CE0000/s2mpu08mfd@00:s2mpu08,irq-gpio:0", "/fragment@model/__overlay__/speedy@11CE0000/s2mpu08mfd@00:interrupt-parent:0", "/fragment@model/__overlay__/usim_det:mif,usim-det0-gpio:0";
		gpg3 = "/fragment@modemif/__overlay__/mif_pdata:gpios:0", "/fragment@camera/__overlay__/fimc-is_sensor_3l6@5A:gpio_reset:0", "/fragment@camera/__overlay__/fimc-is_sensor_5e9@23:gpio_reset:0";
		gpg4 = "/fragment@modemif/__overlay__/mif_pdata:gpios:12", "/fragment@modemif/__overlay__/mif_pdata:gpios:24";
		mali = "/fragment@4:target:0";
		pinctrl_0 = "/fragment@5:target:0", "/fragment@22:target:0", "/fragment@30:target:0", "/fragment@32:target:0", "/fragment@36:target:0", "/fragment@40:target:0";
		i2c_0 = "/fragment@6:target:0";
		exynos_adc = "/fragment@battery/__overlay__/battery:io-channels:0", "/fragment@battery/__overlay__/battery:io-channels:8", "/fragment@model/__overlay__/speedy@11CE0000/cod3035x@03:io-channels:0", "/fragment@model/__overlay__/speedy@11CE0000/cod3035x@03:io-channels:8", "/fragment@model/__overlay__/sec_thermistor@0:io-channels:0", "/fragment@model/__overlay__/sec_thermistor@6:io-channels:0";
		gpp0 = "/fragment@motor/__overlay__/s2mu106-haptic:haptic,motor_en:0";
		fimc_is_mclk2_out = "/fragment@camera/__overlay__/fimc-is_sensor_3l6@5A:pinctrl-1:0", "/fragment@7/__overlay__:pinctrl-0:4";
		fimc_is_mclk2_fn = "/fragment@camera/__overlay__/fimc-is_sensor_3l6@5A:pinctrl-2:0";
		gpc0 = "/fragment@camera/__overlay__/fimc-is_sensor_3l6@5A:gpio_mclk:0", "/fragment@camera/__overlay__/fimc-is_sensor_5e9@23:gpio_mclk:0";
		fimc_is_mclk1_out = "/fragment@camera/__overlay__/fimc-is_sensor_5e9@23:pinctrl-0:0", "/fragment@camera/__overlay__/fimc-is_sensor_5e9@23:pinctrl-1:0", "/fragment@7/__overlay__:pinctrl-0:0";
		fimc_is_mclk1_fn = "/fragment@camera/__overlay__/fimc-is_sensor_5e9@23:pinctrl-2:0";
		gpg0 = "/fragment@camera/__overlay__/fimc-is-flash_gpio@0:torch-gpio:0", "/fragment@17/__overlay__/s2mu106@3D/flash_led:torch-gpio:0";
		fimc_is = "/fragment@7:target:0";
		fimc_is_sensor0 = "/fragment@8:target:0";
		fimc_is_sensor1 = "/fragment@9:target:0";
		fimc_is_sensor2 = "/fragment@10:target:0";
		fimc_is_sensor3 = "/fragment@11:target:0";
		hsi2c_0 = "/fragment@12:target:0";
		gpc1 = "/fragment@12/__overlay__:gpios:0", "/fragment@12/__overlay__:gpios:12", "/fragment@13/__overlay__:gpios:0", "/fragment@13/__overlay__:gpios:12", "/fragment@14/__overlay__:gpios:0", "/fragment@14/__overlay__:gpios:12", "/fragment@15/__overlay__:gpios:0", "/fragment@15/__overlay__:gpios:12";
		hs_i2c0_bus = "/fragment@12/__overlay__:pinctrl-0:0";
		hsi2c_1 = "/fragment@13:target:0";
		hs_i2c1_bus = "/fragment@13/__overlay__:pinctrl-0:0";
		hsi2c_2 = "/fragment@14:target:0";
		hs_i2c2_bus = "/fragment@14/__overlay__:pinctrl-0:0";
		hsi2c_3 = "/fragment@15:target:0";
		hs_i2c3_bus = "/fragment@15/__overlay__:pinctrl-0:0";
		pinctrl_3 = "/fragment@16:target:0", "/fragment@23:target:0", "/fragment@31:target:0", "/fragment@33:target:0", "/fragment@37:target:0", "/fragment@41:target:0";
		i2c_1 = "/fragment@17:target:0";
		gpa1 = "/fragment@model/__overlay__/gpio_keys/button@2:interrupt-parent:0", "/fragment@model/__overlay__/gpio_keys/button@2:gpios:0", "/fragment@model/__overlay__/gpio_keys/button@3:interrupt-parent:0", "/fragment@model/__overlay__/gpio_keys/button@3:gpios:0", "/fragment@model/__overlay__/gpio_keys/button@4:interrupt-parent:0", "/fragment@model/__overlay__/gpio_keys/button@4:gpios:0", "/fragment@35/__overlay__/sec-nfc@27:interrupt-parent:0", "/fragment@35/__overlay__/sec-nfc@27:sec-nfc,irq-gpio:0";
		udc = "/fragment@model/__overlay__/usb_notifier:udc:0", "/fragment@28:target:0";
		sd0_clk = "/fragment@model/__overlay__/dwmmc0@13500000:pinctrl-0:0";
		sd0_cmd = "/fragment@model/__overlay__/dwmmc0@13500000:pinctrl-0:4";
		sd0_rdqs = "/fragment@model/__overlay__/dwmmc0@13500000:pinctrl-0:8";
		sd0_nreset = "/fragment@model/__overlay__/dwmmc0@13500000:pinctrl-0:12";
		sd0_bus1 = "/fragment@model/__overlay__/dwmmc0@13500000:pinctrl-0:16";
		sd0_bus4 = "/fragment@model/__overlay__/dwmmc0@13500000:pinctrl-0:20";
		sd0_bus8 = "/fragment@model/__overlay__/dwmmc0@13500000:pinctrl-0:24";
		sd0_clk_fast_slew_rate_1x = "/fragment@model/__overlay__/dwmmc0@13500000:pinctrl-1:0";
		sd0_clk_fast_slew_rate_2x = "/fragment@model/__overlay__/dwmmc0@13500000:pinctrl-2:0";
		sd0_clk_fast_slew_rate_3x = "/fragment@model/__overlay__/dwmmc0@13500000:pinctrl-3:0";
		sd0_clk_fast_slew_rate_4x = "/fragment@model/__overlay__/dwmmc0@13500000:pinctrl-4:0";
		sd1_clk = "/fragment@model/__overlay__/dwmmc1@13510000:pinctrl-0:0";
		sd1_cmd = "/fragment@model/__overlay__/dwmmc1@13510000:pinctrl-0:4";
		sd1_bus1 = "/fragment@model/__overlay__/dwmmc1@13510000:pinctrl-0:8";
		sd1_bus4 = "/fragment@model/__overlay__/dwmmc1@13510000:pinctrl-0:12";
		sd1_clk_fast_slew_rate_1x = "/fragment@model/__overlay__/dwmmc1@13510000:pinctrl-1:0";
		sd1_clk_fast_slew_rate_2x = "/fragment@model/__overlay__/dwmmc1@13510000:pinctrl-2:0";
		sd1_clk_fast_slew_rate_3x = "/fragment@model/__overlay__/dwmmc1@13510000:pinctrl-3:0";
		sd1_clk_fast_slew_rate_4x = "/fragment@model/__overlay__/dwmmc1@13510000:pinctrl-4:0";
		sd2_clk = "/fragment@model/__overlay__/dwmmc2@13550000:pinctrl-0:0";
		sd2_cmd = "/fragment@model/__overlay__/dwmmc2@13550000:pinctrl-0:4";
		sd2_bus1 = "/fragment@model/__overlay__/dwmmc2@13550000:pinctrl-0:8";
		sd2_bus4 = "/fragment@model/__overlay__/dwmmc2@13550000:pinctrl-0:12";
		sd2_clk_fast_slew_rate_1x = "/fragment@model/__overlay__/dwmmc2@13550000:pinctrl-1:0";
		sd2_clk_fast_slew_rate_2x = "/fragment@model/__overlay__/dwmmc2@13550000:pinctrl-2:0";
		sd2_clk_fast_slew_rate_3x = "/fragment@model/__overlay__/dwmmc2@13550000:pinctrl-3:0";
		sd2_clk_fast_slew_rate_4x = "/fragment@model/__overlay__/dwmmc2@13550000:pinctrl-4:0";
		gpa0 = "/fragment@model/__overlay__/dwmmc2@13550000:card-detect:0", "/fragment@model/__overlay__/flip_cover/hall:gpios:0", "/fragment@model/__overlay__/i2c@20/sx9360-i2c@28:interrupt-parent:0", "/fragment@model/__overlay__/i2c@20/sx9360-i2c@28:sx9360,nirq-gpio:0", "/fragment@27/__overlay__/himax_ts@48:himax,irq-gpio:0", "/fragment@38/__overlay__/gp2a@39:interrupt-parent:0", "/fragment@38/__overlay__/gp2a@39:gp2ap110s,gpio_int:0", "/fragment@39/__overlay__/lsm6dsl@6b:interrupt-parent:0", "/fragment@39/__overlay__/lsm6dsl@6b:st,irq_gpio:0";
		sim0_det_gpio = "/fragment@model/__overlay__/usim_det:pinctrl-0:0";
		gnss_reserved = "/fragment@model/__overlay__/gnss_pdata:memory-region:0";
		abox = "/fragment@model/__overlay__/sound:samsung,codec:0", "/fragment@model/__overlay__/sound/rdma@0/cpu:sound-dai:0", "/fragment@model/__overlay__/sound/rdma@1/cpu:sound-dai:0", "/fragment@model/__overlay__/sound/rdma@2/cpu:sound-dai:0", "/fragment@model/__overlay__/sound/rdma@3/cpu:sound-dai:0", "/fragment@model/__overlay__/sound/rdma@4/cpu:sound-dai:0", "/fragment@model/__overlay__/sound/rdma@5/cpu:sound-dai:0", "/fragment@model/__overlay__/sound/rdma@6/cpu:sound-dai:0", "/fragment@model/__overlay__/sound/rdma@7/cpu:sound-dai:0", "/fragment@model/__overlay__/sound/wdma@0/cpu:sound-dai:0", "/fragment@model/__overlay__/sound/wdma@1/cpu:sound-dai:0", "/fragment@model/__overlay__/sound/wdma@2/cpu:sound-dai:0", "/fragment@model/__overlay__/sound/wdma@3/cpu:sound-dai:0", "/fragment@model/__overlay__/sound/wdma@4/cpu:sound-dai:0", "/fragment@model/__overlay__/sound/uaif@0/cpu:sound-dai:0", "/fragment@model/__overlay__/sound/uaif@1/cpu:sound-dai:0", "/fragment@model/__overlay__/sound/uaif@2/cpu:sound-dai:0", "/fragment@model/__overlay__/sound/uaif@3/cpu:sound-dai:0", "/fragment@model/__overlay__/sound/internal@0/cpu:sound-dai:0", "/fragment@model/__overlay__/sound/speedy@0/cpu:sound-dai:0", "/fragment@24:target:0";
		gpp7 = "/fragment@model/__overlay__/i2c@20:gpios:0", "/fragment@model/__overlay__/i2c@20:gpios:12";
		chosen = "/fragment@18:target:0";
		serial_2 = "/fragment@19:target:0";
		cpufreq_domain0 = "/fragment@20:target:0";
		cpufreq_domain1 = "/fragment@21:target:0";
		aud_codec_mclk = "/fragment@24/__overlay__:pinctrl-0:0";
		aud_codec_bus = "/fragment@24/__overlay__:pinctrl-0:4";
		aud_fm_bus = "/fragment@24/__overlay__:pinctrl-0:8";
		aud_spk_bus = "/fragment@24/__overlay__:pinctrl-0:12";
		aud_loopback_bus = "/fragment@24/__overlay__:pinctrl-0:16";
		aud_codec_mclk_idle = "/fragment@24/__overlay__:pinctrl-1:0";
		aud_codec_bus_idle = "/fragment@24/__overlay__:pinctrl-1:4";
		aud_fm_bus_idle = "/fragment@24/__overlay__:pinctrl-1:8";
		aud_spk_bus_idle = "/fragment@24/__overlay__:pinctrl-1:12";
		aud_loopback_bus_idle = "/fragment@24/__overlay__:pinctrl-1:16";
		i2c_3 = "/fragment@25:target:0";
		i2c4_bus = "/fragment@26:target:0";
		i2c_4 = "/fragment@27:target:0";
		usbdrd_phy = "/fragment@29:target:0";
		usi_0 = "/fragment@34:target:0";
		hsi2c_5 = "/fragment@35:target:0";
		gpp2 = "/fragment@35/__overlay__/sec-nfc@27:sec-nfc,nfc_pd:0";
		gpp3 = "/fragment@35/__overlay__/sec-nfc@27:sec-nfc,firm-gpio:0";
		gpp6 = "/fragment@35/__overlay__/sec-nfc@27:sec-nfc,pvdd_en:0";
		i2c_5 = "/fragment@38:target:0";
		i2c_6 = "/fragment@39:target:0";
	};

	__local_fixups__ {

		fragment@lcd {

			__overlay__ {

				hx83102d {
					decon_board = <0x0>;
				};
			};
		};

		fragment@0 {

			__overlay__ {
				lcd_info = <0x0>;
			};
		};

		fragment@ifpmic {

			__overlay__ {

				i2c@13840000 {

					s2mu106@3D {
						pinctrl-0 = <0x0>;
					};
				};

				i2c@13830000 {

					usbpd-s2mu106@3C {
						pinctrl-0 = <0x0>;
					};
				};
			};
		};

		fragment@6 {

			__overlay__ {

				s2mu106-fuelgauge@3B {
					pinctrl-0 = <0x0>;
				};
			};
		};

		fragment@17 {

			__overlay__ {

				s2mu106@3D {

					flash_led {
						pinctrl-1 = <0x0>;
					};
				};
			};
		};

		fragment@model {

			__overlay__ {

				gpio_keys {
					pinctrl-0 = <0x0 0x4 0x8>;
				};

				speedy@11CE0000 {

					cod3035x@03 {
						vdd-supply = <0x0>;
						but-zones-list = <0x0 0x10 0x20 0x30>;
					};

					s2mpu08mfd@00 {
						samsung,codec-interrupt = <0x0>;
						pinctrl-0 = <0x0 0x4>;
					};
				};

				dwmmc2@13550000 {
					pinctrl-0 = <0x10>;
				};

				gnss_pdata {
					mbox_info = <0x0>;
				};

				sound {

					rdma@0 {

						codec {
							sound-dai = <0x0>;
						};
					};

					rdma@1 {

						codec {
							sound-dai = <0x0>;
						};
					};

					rdma@2 {

						codec {
							sound-dai = <0x0>;
						};
					};

					rdma@3 {

						codec {
							sound-dai = <0x0>;
						};
					};

					rdma@4 {

						codec {
							sound-dai = <0x0>;
						};
					};

					rdma@5 {

						codec {
							sound-dai = <0x0>;
						};
					};

					rdma@6 {

						codec {
							sound-dai = <0x0>;
						};
					};

					rdma@7 {

						codec {
							sound-dai = <0x0>;
						};
					};

					wdma@0 {

						codec {
							sound-dai = <0x0>;
						};
					};

					wdma@1 {

						codec {
							sound-dai = <0x0>;
						};
					};

					wdma@2 {

						codec {
							sound-dai = <0x0>;
						};
					};

					wdma@3 {

						codec {
							sound-dai = <0x0>;
						};
					};

					wdma@4 {

						codec {
							sound-dai = <0x0>;
						};
					};

					uaif@0 {

						codec {
							sound-dai = <0x0>;
						};
					};

					uaif@1 {

						codec {
							sound-dai = <0x0>;
						};
					};

					uaif@2 {

						codec {
							sound-dai = <0x0>;
						};
					};

					uaif@3 {

						codec {
							sound-dai = <0x0>;
						};
					};

					internal@0 {

						codec {
							sound-dai = <0x0>;
						};
					};

					speedy@0 {

						codec {
							sound-dai = <0x0>;
						};
					};
				};

				flip_cover {
					pinctrl-0 = <0x0>;
				};

				i2c@20 {
					pinctrl-0 = <0x0 0x4>;

					sx9360-i2c@28 {
						pinctrl-0 = <0x0>;
					};
				};
			};
		};

		fragment@25 {

			__overlay__ {
				pinctrl-0 = <0x0>;
			};
		};

		fragment@27 {

			__overlay__ {

				himax_ts@48 {
					pinctrl-0 = <0x0>;
				};
			};
		};

		fragment@29 {

			__overlay__ {
				hs_tune_param = <0x0>;
			};
		};

		fragment@35 {

			__overlay__ {

				sec-nfc@27 {
					pinctrl-0 = <0x0 0x4 0x8 0xc>;
				};
			};
		};

		fragment@38 {

			__overlay__ {
				pinctrl-0 = <0x0>;

				gp2a@39 {
					pinctrl-0 = <0x0 0x4>;
				};
			};
		};

		fragment@39 {

			__overlay__ {
				pinctrl-0 = <0x0 0x4>;

				lsm6dsl@6b {
					pinctrl-0 = <0x0 0x4>;
				};
			};
		};

		fragment@40 {

			__overlay__ {
				pinctrl-0 = <0x0>;
			};
		};

		fragment@41 {

			__overlay__ {
				pinctrl-0 = <0x0>;
				pinctrl-1 = <0x0>;
			};
		};
	};
};
